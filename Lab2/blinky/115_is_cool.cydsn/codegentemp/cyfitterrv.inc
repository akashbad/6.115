    IF :LNOT::DEF:INCLUDED_CYFITTERRV_INC
INCLUDED_CYFITTERRV_INC EQU 1
    GET cydevicerv.inc
    GET cydevicerv_trm.inc

; A
A__0__MASK EQU 0x08
A__0__PC EQU CYREG_PRT5_PC3
A__0__PORT EQU 5
A__0__SHIFT EQU 3
A__AG EQU CYREG_PRT5_AG
A__AMUX EQU CYREG_PRT5_AMUX
A__BIE EQU CYREG_PRT5_BIE
A__BIT_MASK EQU CYREG_PRT5_BIT_MASK
A__BYP EQU CYREG_PRT5_BYP
A__CTL EQU CYREG_PRT5_CTL
A__DM0 EQU CYREG_PRT5_DM0
A__DM1 EQU CYREG_PRT5_DM1
A__DM2 EQU CYREG_PRT5_DM2
A__DR EQU CYREG_PRT5_DR
A__INP_DIS EQU CYREG_PRT5_INP_DIS
A__LCD_COM_SEG EQU CYREG_PRT5_LCD_COM_SEG
A__LCD_EN EQU CYREG_PRT5_LCD_EN
A__MASK EQU 0x08
A__PORT EQU 5
A__PRT EQU CYREG_PRT5_PRT
A__PRTDSI__CAPS_SEL EQU CYREG_PRT5_CAPS_SEL
A__PRTDSI__DBL_SYNC_IN EQU CYREG_PRT5_DBL_SYNC_IN
A__PRTDSI__OE_SEL0 EQU CYREG_PRT5_OE_SEL0
A__PRTDSI__OE_SEL1 EQU CYREG_PRT5_OE_SEL1
A__PRTDSI__OUT_SEL0 EQU CYREG_PRT5_OUT_SEL0
A__PRTDSI__OUT_SEL1 EQU CYREG_PRT5_OUT_SEL1
A__PRTDSI__SYNC_OUT EQU CYREG_PRT5_SYNC_OUT
A__PS EQU CYREG_PRT5_PS
A__SHIFT EQU 3
A__SLW EQU CYREG_PRT5_SLW

; B
B__0__MASK EQU 0x04
B__0__PC EQU CYREG_PRT5_PC2
B__0__PORT EQU 5
B__0__SHIFT EQU 2
B__AG EQU CYREG_PRT5_AG
B__AMUX EQU CYREG_PRT5_AMUX
B__BIE EQU CYREG_PRT5_BIE
B__BIT_MASK EQU CYREG_PRT5_BIT_MASK
B__BYP EQU CYREG_PRT5_BYP
B__CTL EQU CYREG_PRT5_CTL
B__DM0 EQU CYREG_PRT5_DM0
B__DM1 EQU CYREG_PRT5_DM1
B__DM2 EQU CYREG_PRT5_DM2
B__DR EQU CYREG_PRT5_DR
B__INP_DIS EQU CYREG_PRT5_INP_DIS
B__LCD_COM_SEG EQU CYREG_PRT5_LCD_COM_SEG
B__LCD_EN EQU CYREG_PRT5_LCD_EN
B__MASK EQU 0x04
B__PORT EQU 5
B__PRT EQU CYREG_PRT5_PRT
B__PRTDSI__CAPS_SEL EQU CYREG_PRT5_CAPS_SEL
B__PRTDSI__DBL_SYNC_IN EQU CYREG_PRT5_DBL_SYNC_IN
B__PRTDSI__OE_SEL0 EQU CYREG_PRT5_OE_SEL0
B__PRTDSI__OE_SEL1 EQU CYREG_PRT5_OE_SEL1
B__PRTDSI__OUT_SEL0 EQU CYREG_PRT5_OUT_SEL0
B__PRTDSI__OUT_SEL1 EQU CYREG_PRT5_OUT_SEL1
B__PRTDSI__SYNC_OUT EQU CYREG_PRT5_SYNC_OUT
B__PS EQU CYREG_PRT5_PS
B__SHIFT EQU 2
B__SLW EQU CYREG_PRT5_SLW

; C
C__0__MASK EQU 0x02
C__0__PC EQU CYREG_PRT5_PC1
C__0__PORT EQU 5
C__0__SHIFT EQU 1
C__AG EQU CYREG_PRT5_AG
C__AMUX EQU CYREG_PRT5_AMUX
C__BIE EQU CYREG_PRT5_BIE
C__BIT_MASK EQU CYREG_PRT5_BIT_MASK
C__BYP EQU CYREG_PRT5_BYP
C__CTL EQU CYREG_PRT5_CTL
C__DM0 EQU CYREG_PRT5_DM0
C__DM1 EQU CYREG_PRT5_DM1
C__DM2 EQU CYREG_PRT5_DM2
C__DR EQU CYREG_PRT5_DR
C__INP_DIS EQU CYREG_PRT5_INP_DIS
C__LCD_COM_SEG EQU CYREG_PRT5_LCD_COM_SEG
C__LCD_EN EQU CYREG_PRT5_LCD_EN
C__MASK EQU 0x02
C__PORT EQU 5
C__PRT EQU CYREG_PRT5_PRT
C__PRTDSI__CAPS_SEL EQU CYREG_PRT5_CAPS_SEL
C__PRTDSI__DBL_SYNC_IN EQU CYREG_PRT5_DBL_SYNC_IN
C__PRTDSI__OE_SEL0 EQU CYREG_PRT5_OE_SEL0
C__PRTDSI__OE_SEL1 EQU CYREG_PRT5_OE_SEL1
C__PRTDSI__OUT_SEL0 EQU CYREG_PRT5_OUT_SEL0
C__PRTDSI__OUT_SEL1 EQU CYREG_PRT5_OUT_SEL1
C__PRTDSI__SYNC_OUT EQU CYREG_PRT5_SYNC_OUT
C__PS EQU CYREG_PRT5_PS
C__SHIFT EQU 1
C__SLW EQU CYREG_PRT5_SLW

; D
D__0__MASK EQU 0x04
D__0__PC EQU CYREG_PRT12_PC2
D__0__PORT EQU 12
D__0__SHIFT EQU 2
D__AG EQU CYREG_PRT12_AG
D__BIE EQU CYREG_PRT12_BIE
D__BIT_MASK EQU CYREG_PRT12_BIT_MASK
D__BYP EQU CYREG_PRT12_BYP
D__DM0 EQU CYREG_PRT12_DM0
D__DM1 EQU CYREG_PRT12_DM1
D__DM2 EQU CYREG_PRT12_DM2
D__DR EQU CYREG_PRT12_DR
D__INP_DIS EQU CYREG_PRT12_INP_DIS
D__MASK EQU 0x04
D__PORT EQU 12
D__PRT EQU CYREG_PRT12_PRT
D__PRTDSI__DBL_SYNC_IN EQU CYREG_PRT12_DBL_SYNC_IN
D__PRTDSI__OE_SEL0 EQU CYREG_PRT12_OE_SEL0
D__PRTDSI__OE_SEL1 EQU CYREG_PRT12_OE_SEL1
D__PRTDSI__OUT_SEL0 EQU CYREG_PRT12_OUT_SEL0
D__PRTDSI__OUT_SEL1 EQU CYREG_PRT12_OUT_SEL1
D__PRTDSI__SYNC_OUT EQU CYREG_PRT12_SYNC_OUT
D__PS EQU CYREG_PRT12_PS
D__SHIFT EQU 2
D__SIO_CFG EQU CYREG_PRT12_SIO_CFG
D__SIO_DIFF EQU CYREG_PRT12_SIO_DIFF
D__SIO_HYST_EN EQU CYREG_PRT12_SIO_HYST_EN
D__SIO_REG_HIFREQ EQU CYREG_PRT12_SIO_REG_HIFREQ
D__SLW EQU CYREG_PRT12_SLW

; E
E__0__MASK EQU 0x02
E__0__PC EQU CYREG_PRT12_PC1
E__0__PORT EQU 12
E__0__SHIFT EQU 1
E__AG EQU CYREG_PRT12_AG
E__BIE EQU CYREG_PRT12_BIE
E__BIT_MASK EQU CYREG_PRT12_BIT_MASK
E__BYP EQU CYREG_PRT12_BYP
E__DM0 EQU CYREG_PRT12_DM0
E__DM1 EQU CYREG_PRT12_DM1
E__DM2 EQU CYREG_PRT12_DM2
E__DR EQU CYREG_PRT12_DR
E__INP_DIS EQU CYREG_PRT12_INP_DIS
E__MASK EQU 0x02
E__PORT EQU 12
E__PRT EQU CYREG_PRT12_PRT
E__PRTDSI__DBL_SYNC_IN EQU CYREG_PRT12_DBL_SYNC_IN
E__PRTDSI__OE_SEL0 EQU CYREG_PRT12_OE_SEL0
E__PRTDSI__OE_SEL1 EQU CYREG_PRT12_OE_SEL1
E__PRTDSI__OUT_SEL0 EQU CYREG_PRT12_OUT_SEL0
E__PRTDSI__OUT_SEL1 EQU CYREG_PRT12_OUT_SEL1
E__PRTDSI__SYNC_OUT EQU CYREG_PRT12_SYNC_OUT
E__PS EQU CYREG_PRT12_PS
E__SHIFT EQU 1
E__SIO_CFG EQU CYREG_PRT12_SIO_CFG
E__SIO_DIFF EQU CYREG_PRT12_SIO_DIFF
E__SIO_HYST_EN EQU CYREG_PRT12_SIO_HYST_EN
E__SIO_REG_HIFREQ EQU CYREG_PRT12_SIO_REG_HIFREQ
E__SLW EQU CYREG_PRT12_SLW

; F
F__0__MASK EQU 0x08
F__0__PC EQU CYREG_PRT12_PC3
F__0__PORT EQU 12
F__0__SHIFT EQU 3
F__AG EQU CYREG_PRT12_AG
F__BIE EQU CYREG_PRT12_BIE
F__BIT_MASK EQU CYREG_PRT12_BIT_MASK
F__BYP EQU CYREG_PRT12_BYP
F__DM0 EQU CYREG_PRT12_DM0
F__DM1 EQU CYREG_PRT12_DM1
F__DM2 EQU CYREG_PRT12_DM2
F__DR EQU CYREG_PRT12_DR
F__INP_DIS EQU CYREG_PRT12_INP_DIS
F__MASK EQU 0x08
F__PORT EQU 12
F__PRT EQU CYREG_PRT12_PRT
F__PRTDSI__DBL_SYNC_IN EQU CYREG_PRT12_DBL_SYNC_IN
F__PRTDSI__OE_SEL0 EQU CYREG_PRT12_OE_SEL0
F__PRTDSI__OE_SEL1 EQU CYREG_PRT12_OE_SEL1
F__PRTDSI__OUT_SEL0 EQU CYREG_PRT12_OUT_SEL0
F__PRTDSI__OUT_SEL1 EQU CYREG_PRT12_OUT_SEL1
F__PRTDSI__SYNC_OUT EQU CYREG_PRT12_SYNC_OUT
F__PS EQU CYREG_PRT12_PS
F__SHIFT EQU 3
F__SIO_CFG EQU CYREG_PRT12_SIO_CFG
F__SIO_DIFF EQU CYREG_PRT12_SIO_DIFF
F__SIO_HYST_EN EQU CYREG_PRT12_SIO_HYST_EN
F__SIO_REG_HIFREQ EQU CYREG_PRT12_SIO_REG_HIFREQ
F__SLW EQU CYREG_PRT12_SLW

; G
G__0__MASK EQU 0x01
G__0__PC EQU CYREG_PRT12_PC0
G__0__PORT EQU 12
G__0__SHIFT EQU 0
G__AG EQU CYREG_PRT12_AG
G__BIE EQU CYREG_PRT12_BIE
G__BIT_MASK EQU CYREG_PRT12_BIT_MASK
G__BYP EQU CYREG_PRT12_BYP
G__DM0 EQU CYREG_PRT12_DM0
G__DM1 EQU CYREG_PRT12_DM1
G__DM2 EQU CYREG_PRT12_DM2
G__DR EQU CYREG_PRT12_DR
G__INP_DIS EQU CYREG_PRT12_INP_DIS
G__MASK EQU 0x01
G__PORT EQU 12
G__PRT EQU CYREG_PRT12_PRT
G__PRTDSI__DBL_SYNC_IN EQU CYREG_PRT12_DBL_SYNC_IN
G__PRTDSI__OE_SEL0 EQU CYREG_PRT12_OE_SEL0
G__PRTDSI__OE_SEL1 EQU CYREG_PRT12_OE_SEL1
G__PRTDSI__OUT_SEL0 EQU CYREG_PRT12_OUT_SEL0
G__PRTDSI__OUT_SEL1 EQU CYREG_PRT12_OUT_SEL1
G__PRTDSI__SYNC_OUT EQU CYREG_PRT12_SYNC_OUT
G__PS EQU CYREG_PRT12_PS
G__SHIFT EQU 0
G__SIO_CFG EQU CYREG_PRT12_SIO_CFG
G__SIO_DIFF EQU CYREG_PRT12_SIO_DIFF
G__SIO_HYST_EN EQU CYREG_PRT12_SIO_HYST_EN
G__SIO_REG_HIFREQ EQU CYREG_PRT12_SIO_REG_HIFREQ
G__SLW EQU CYREG_PRT12_SLW

; P
P__0__MASK EQU 0x01
P__0__PC EQU CYREG_PRT5_PC0
P__0__PORT EQU 5
P__0__SHIFT EQU 0
P__AG EQU CYREG_PRT5_AG
P__AMUX EQU CYREG_PRT5_AMUX
P__BIE EQU CYREG_PRT5_BIE
P__BIT_MASK EQU CYREG_PRT5_BIT_MASK
P__BYP EQU CYREG_PRT5_BYP
P__CTL EQU CYREG_PRT5_CTL
P__DM0 EQU CYREG_PRT5_DM0
P__DM1 EQU CYREG_PRT5_DM1
P__DM2 EQU CYREG_PRT5_DM2
P__DR EQU CYREG_PRT5_DR
P__INP_DIS EQU CYREG_PRT5_INP_DIS
P__LCD_COM_SEG EQU CYREG_PRT5_LCD_COM_SEG
P__LCD_EN EQU CYREG_PRT5_LCD_EN
P__MASK EQU 0x01
P__PORT EQU 5
P__PRT EQU CYREG_PRT5_PRT
P__PRTDSI__CAPS_SEL EQU CYREG_PRT5_CAPS_SEL
P__PRTDSI__DBL_SYNC_IN EQU CYREG_PRT5_DBL_SYNC_IN
P__PRTDSI__OE_SEL0 EQU CYREG_PRT5_OE_SEL0
P__PRTDSI__OE_SEL1 EQU CYREG_PRT5_OE_SEL1
P__PRTDSI__OUT_SEL0 EQU CYREG_PRT5_OUT_SEL0
P__PRTDSI__OUT_SEL1 EQU CYREG_PRT5_OUT_SEL1
P__PRTDSI__SYNC_OUT EQU CYREG_PRT5_SYNC_OUT
P__PS EQU CYREG_PRT5_PS
P__SHIFT EQU 0
P__SLW EQU CYREG_PRT5_SLW

; Miscellaneous
; -- WARNING: define names containing LEOPARD or PANTHER are deprecated and will be removed in a future release
CYDEV_DEBUGGING_DPS_SWD_SWV EQU 6
CYDEV_CONFIG_UNUSED_IO_AllowButWarn EQU 0
CYDEV_CONFIGURATION_MODE_COMPRESSED EQU 0
CYDEV_CONFIG_FASTBOOT_ENABLED EQU 1
CYDEV_CHIP_REV_PSOC5LP_PRODUCTION EQU 0
CYDEV_CHIP_REVISION_5B_PRODUCTION EQU 0
CYDEV_CHIP_MEMBER_5B EQU 4
CYDEV_CHIP_FAMILY_PSOC5 EQU 3
CYDEV_CHIP_DIE_PSOC5LP EQU 4
CYDEV_CHIP_DIE_EXPECT EQU CYDEV_CHIP_DIE_PSOC5LP
BCLK__BUS_CLK__HZ EQU 24000000
BCLK__BUS_CLK__KHZ EQU 24000
BCLK__BUS_CLK__MHZ EQU 24
CYDEV_CHIP_DIE_ACTUAL EQU CYDEV_CHIP_DIE_EXPECT
CYDEV_CHIP_DIE_LEOPARD EQU 1
CYDEV_CHIP_DIE_PANTHER EQU 3
CYDEV_CHIP_DIE_PSOC4A EQU 2
CYDEV_CHIP_DIE_UNKNOWN EQU 0
CYDEV_CHIP_FAMILY_PSOC3 EQU 1
CYDEV_CHIP_FAMILY_PSOC4 EQU 2
CYDEV_CHIP_FAMILY_UNKNOWN EQU 0
CYDEV_CHIP_FAMILY_USED EQU CYDEV_CHIP_FAMILY_PSOC5
CYDEV_CHIP_JTAG_ID EQU 0x2E123069
CYDEV_CHIP_MEMBER_3A EQU 1
CYDEV_CHIP_MEMBER_4A EQU 2
CYDEV_CHIP_MEMBER_5A EQU 3
CYDEV_CHIP_MEMBER_UNKNOWN EQU 0
CYDEV_CHIP_MEMBER_USED EQU CYDEV_CHIP_MEMBER_5B
CYDEV_CHIP_REVISION_3A_ES1 EQU 0
CYDEV_CHIP_REVISION_3A_ES2 EQU 1
CYDEV_CHIP_REVISION_3A_ES3 EQU 3
CYDEV_CHIP_REVISION_3A_PRODUCTION EQU 3
CYDEV_CHIP_REVISION_4A_ES0 EQU 17
CYDEV_CHIP_REVISION_4A_PRODUCTION EQU 17
CYDEV_CHIP_REVISION_5A_ES0 EQU 0
CYDEV_CHIP_REVISION_5A_ES1 EQU 1
CYDEV_CHIP_REVISION_5A_PRODUCTION EQU 1
CYDEV_CHIP_REVISION_5B_ES0 EQU 0
CYDEV_CHIP_REVISION_USED EQU CYDEV_CHIP_REVISION_5B_PRODUCTION
CYDEV_CHIP_REV_EXPECT EQU CYDEV_CHIP_REV_PSOC5LP_PRODUCTION
CYDEV_CHIP_REV_LEOPARD_ES1 EQU 0
CYDEV_CHIP_REV_LEOPARD_ES2 EQU 1
CYDEV_CHIP_REV_LEOPARD_ES3 EQU 3
CYDEV_CHIP_REV_LEOPARD_PRODUCTION EQU 3
CYDEV_CHIP_REV_PANTHER_ES0 EQU 0
CYDEV_CHIP_REV_PANTHER_ES1 EQU 1
CYDEV_CHIP_REV_PANTHER_PRODUCTION EQU 1
CYDEV_CHIP_REV_PSOC4A_ES0 EQU 17
CYDEV_CHIP_REV_PSOC4A_PRODUCTION EQU 17
CYDEV_CHIP_REV_PSOC5LP_ES0 EQU 0
CYDEV_CONFIGURATION_COMPRESSED EQU 1
CYDEV_CONFIGURATION_DMA EQU 0
CYDEV_CONFIGURATION_ECC EQU 1
CYDEV_CONFIGURATION_IMOENABLED EQU CYDEV_CONFIG_FASTBOOT_ENABLED
CYDEV_CONFIGURATION_MODE EQU CYDEV_CONFIGURATION_MODE_COMPRESSED
CYDEV_CONFIGURATION_MODE_DMA EQU 2
CYDEV_CONFIGURATION_MODE_UNCOMPRESSED EQU 1
CYDEV_CONFIG_UNUSED_IO EQU CYDEV_CONFIG_UNUSED_IO_AllowButWarn
CYDEV_CONFIG_UNUSED_IO_AllowWithInfo EQU 1
CYDEV_CONFIG_UNUSED_IO_Disallowed EQU 2
CYDEV_DEBUGGING_DPS EQU CYDEV_DEBUGGING_DPS_SWD_SWV
CYDEV_DEBUGGING_DPS_Disable EQU 3
CYDEV_DEBUGGING_DPS_JTAG_4 EQU 1
CYDEV_DEBUGGING_DPS_JTAG_5 EQU 0
CYDEV_DEBUGGING_DPS_SWD EQU 2
CYDEV_DEBUGGING_ENABLE EQU 1
CYDEV_DEBUGGING_XRES EQU 0
CYDEV_DEBUG_ENABLE_MASK EQU 0x20
CYDEV_DEBUG_ENABLE_REGISTER EQU CYREG_MLOGIC_DEBUG
CYDEV_DMA_CHANNELS_AVAILABLE EQU 24
CYDEV_ECC_ENABLE EQU 0
CYDEV_HEAP_SIZE EQU 0x1000
CYDEV_INSTRUCT_CACHE_ENABLED EQU 1
CYDEV_INTR_RISING EQU 0x00000000
CYDEV_PROJ_TYPE EQU 0
CYDEV_PROJ_TYPE_BOOTLOADER EQU 1
CYDEV_PROJ_TYPE_LOADABLE EQU 2
CYDEV_PROJ_TYPE_MULTIAPPBOOTLOADER EQU 3
CYDEV_PROJ_TYPE_STANDARD EQU 0
CYDEV_PROTECTION_ENABLE EQU 0
CYDEV_STACK_SIZE EQU 0x4000
CYDEV_USE_BUNDLED_CMSIS EQU 1
CYDEV_VARIABLE_VDDA EQU 0
CYDEV_VDDA_MV EQU 5000
CYDEV_VDDD_MV EQU 5000
CYDEV_VDDIO0_MV EQU 5000
CYDEV_VDDIO1_MV EQU 5000
CYDEV_VDDIO2_MV EQU 5000
CYDEV_VDDIO3_MV EQU 5000
CYDEV_VIO0 EQU 5
CYDEV_VIO0_MV EQU 5000
CYDEV_VIO1 EQU 5
CYDEV_VIO1_MV EQU 5000
CYDEV_VIO2 EQU 5
CYDEV_VIO2_MV EQU 5000
CYDEV_VIO3 EQU 5
CYDEV_VIO3_MV EQU 5000
DMA_CHANNELS_USED__MASK0 EQU 0x00000000
CYDEV_BOOTLOADER_ENABLE EQU 0
    ENDIF
    END
