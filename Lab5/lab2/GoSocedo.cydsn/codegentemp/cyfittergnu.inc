.ifndef INCLUDED_CYFITTERGNU_INC
.set INCLUDED_CYFITTERGNU_INC, 1
.include "cydevicegnu.inc"
.include "cydevicegnu_trm.inc"

/* ADC_Ext_CP_Clk */
.set ADC_Ext_CP_Clk__CFG0, CYREG_CLKDIST_DCFG0_CFG0
.set ADC_Ext_CP_Clk__CFG1, CYREG_CLKDIST_DCFG0_CFG1
.set ADC_Ext_CP_Clk__CFG2, CYREG_CLKDIST_DCFG0_CFG2
.set ADC_Ext_CP_Clk__CFG2_SRC_SEL_MASK, 0x07
.set ADC_Ext_CP_Clk__INDEX, 0x00
.set ADC_Ext_CP_Clk__PM_ACT_CFG, CYREG_PM_ACT_CFG2
.set ADC_Ext_CP_Clk__PM_ACT_MSK, 0x01
.set ADC_Ext_CP_Clk__PM_STBY_CFG, CYREG_PM_STBY_CFG2
.set ADC_Ext_CP_Clk__PM_STBY_MSK, 0x01

/* ADC_theACLK */
.set ADC_theACLK__CFG0, CYREG_CLKDIST_ACFG0_CFG0
.set ADC_theACLK__CFG1, CYREG_CLKDIST_ACFG0_CFG1
.set ADC_theACLK__CFG2, CYREG_CLKDIST_ACFG0_CFG2
.set ADC_theACLK__CFG2_SRC_SEL_MASK, 0x07
.set ADC_theACLK__CFG3, CYREG_CLKDIST_ACFG0_CFG3
.set ADC_theACLK__CFG3_PHASE_DLY_MASK, 0x0F
.set ADC_theACLK__INDEX, 0x00
.set ADC_theACLK__PM_ACT_CFG, CYREG_PM_ACT_CFG1
.set ADC_theACLK__PM_ACT_MSK, 0x01
.set ADC_theACLK__PM_STBY_CFG, CYREG_PM_STBY_CFG1
.set ADC_theACLK__PM_STBY_MSK, 0x01

/* LCD_LCDPort */
.set LCD_LCDPort__0__MASK, 0x01
.set LCD_LCDPort__0__PC, CYREG_PRT2_PC0
.set LCD_LCDPort__0__PORT, 2
.set LCD_LCDPort__0__SHIFT, 0
.set LCD_LCDPort__1__MASK, 0x02
.set LCD_LCDPort__1__PC, CYREG_PRT2_PC1
.set LCD_LCDPort__1__PORT, 2
.set LCD_LCDPort__1__SHIFT, 1
.set LCD_LCDPort__2__MASK, 0x04
.set LCD_LCDPort__2__PC, CYREG_PRT2_PC2
.set LCD_LCDPort__2__PORT, 2
.set LCD_LCDPort__2__SHIFT, 2
.set LCD_LCDPort__3__MASK, 0x08
.set LCD_LCDPort__3__PC, CYREG_PRT2_PC3
.set LCD_LCDPort__3__PORT, 2
.set LCD_LCDPort__3__SHIFT, 3
.set LCD_LCDPort__4__MASK, 0x10
.set LCD_LCDPort__4__PC, CYREG_PRT2_PC4
.set LCD_LCDPort__4__PORT, 2
.set LCD_LCDPort__4__SHIFT, 4
.set LCD_LCDPort__5__MASK, 0x20
.set LCD_LCDPort__5__PC, CYREG_PRT2_PC5
.set LCD_LCDPort__5__PORT, 2
.set LCD_LCDPort__5__SHIFT, 5
.set LCD_LCDPort__6__MASK, 0x40
.set LCD_LCDPort__6__PC, CYREG_PRT2_PC6
.set LCD_LCDPort__6__PORT, 2
.set LCD_LCDPort__6__SHIFT, 6
.set LCD_LCDPort__AG, CYREG_PRT2_AG
.set LCD_LCDPort__AMUX, CYREG_PRT2_AMUX
.set LCD_LCDPort__BIE, CYREG_PRT2_BIE
.set LCD_LCDPort__BIT_MASK, CYREG_PRT2_BIT_MASK
.set LCD_LCDPort__BYP, CYREG_PRT2_BYP
.set LCD_LCDPort__CTL, CYREG_PRT2_CTL
.set LCD_LCDPort__DM0, CYREG_PRT2_DM0
.set LCD_LCDPort__DM1, CYREG_PRT2_DM1
.set LCD_LCDPort__DM2, CYREG_PRT2_DM2
.set LCD_LCDPort__DR, CYREG_PRT2_DR
.set LCD_LCDPort__INP_DIS, CYREG_PRT2_INP_DIS
.set LCD_LCDPort__LCD_COM_SEG, CYREG_PRT2_LCD_COM_SEG
.set LCD_LCDPort__LCD_EN, CYREG_PRT2_LCD_EN
.set LCD_LCDPort__MASK, 0x7F
.set LCD_LCDPort__PORT, 2
.set LCD_LCDPort__PRT, CYREG_PRT2_PRT
.set LCD_LCDPort__PRTDSI__CAPS_SEL, CYREG_PRT2_CAPS_SEL
.set LCD_LCDPort__PRTDSI__DBL_SYNC_IN, CYREG_PRT2_DBL_SYNC_IN
.set LCD_LCDPort__PRTDSI__OE_SEL0, CYREG_PRT2_OE_SEL0
.set LCD_LCDPort__PRTDSI__OE_SEL1, CYREG_PRT2_OE_SEL1
.set LCD_LCDPort__PRTDSI__OUT_SEL0, CYREG_PRT2_OUT_SEL0
.set LCD_LCDPort__PRTDSI__OUT_SEL1, CYREG_PRT2_OUT_SEL1
.set LCD_LCDPort__PRTDSI__SYNC_OUT, CYREG_PRT2_SYNC_OUT
.set LCD_LCDPort__PS, CYREG_PRT2_PS
.set LCD_LCDPort__SHIFT, 0
.set LCD_LCDPort__SLW, CYREG_PRT2_SLW

/* ADCclock */
.set ADCclock__CFG0, CYREG_CLKDIST_ACFG1_CFG0
.set ADCclock__CFG1, CYREG_CLKDIST_ACFG1_CFG1
.set ADCclock__CFG2, CYREG_CLKDIST_ACFG1_CFG2
.set ADCclock__CFG2_SRC_SEL_MASK, 0x07
.set ADCclock__CFG3, CYREG_CLKDIST_ACFG1_CFG3
.set ADCclock__CFG3_PHASE_DLY_MASK, 0x0F
.set ADCclock__INDEX, 0x01
.set ADCclock__PM_ACT_CFG, CYREG_PM_ACT_CFG1
.set ADCclock__PM_ACT_MSK, 0x02
.set ADCclock__PM_STBY_CFG, CYREG_PM_STBY_CFG1
.set ADCclock__PM_STBY_MSK, 0x02

/* ADC_DEC */
.set ADC_DEC__COHER, CYREG_DEC_COHER
.set ADC_DEC__CR, CYREG_DEC_CR
.set ADC_DEC__DR1, CYREG_DEC_DR1
.set ADC_DEC__DR2, CYREG_DEC_DR2
.set ADC_DEC__DR2H, CYREG_DEC_DR2H
.set ADC_DEC__GCOR, CYREG_DEC_GCOR
.set ADC_DEC__GCORH, CYREG_DEC_GCORH
.set ADC_DEC__GVAL, CYREG_DEC_GVAL
.set ADC_DEC__OCOR, CYREG_DEC_OCOR
.set ADC_DEC__OCORH, CYREG_DEC_OCORH
.set ADC_DEC__OCORM, CYREG_DEC_OCORM
.set ADC_DEC__OUTSAMP, CYREG_DEC_OUTSAMP
.set ADC_DEC__OUTSAMPH, CYREG_DEC_OUTSAMPH
.set ADC_DEC__OUTSAMPM, CYREG_DEC_OUTSAMPM
.set ADC_DEC__OUTSAMPS, CYREG_DEC_OUTSAMPS
.set ADC_DEC__PM_ACT_CFG, CYREG_PM_ACT_CFG10
.set ADC_DEC__PM_ACT_MSK, 0x01
.set ADC_DEC__PM_STBY_CFG, CYREG_PM_STBY_CFG10
.set ADC_DEC__PM_STBY_MSK, 0x01
.set ADC_DEC__SHIFT1, CYREG_DEC_SHIFT1
.set ADC_DEC__SHIFT2, CYREG_DEC_SHIFT2
.set ADC_DEC__SR, CYREG_DEC_SR
.set ADC_DEC__TRIM__M1, CYREG_FLSHID_CUST_TABLES_DEC_M1
.set ADC_DEC__TRIM__M2, CYREG_FLSHID_CUST_TABLES_DEC_M2
.set ADC_DEC__TRIM__M3, CYREG_FLSHID_CUST_TABLES_DEC_M3
.set ADC_DEC__TRIM__M4, CYREG_FLSHID_CUST_TABLES_DEC_M4
.set ADC_DEC__TRIM__M5, CYREG_FLSHID_CUST_TABLES_DEC_M5
.set ADC_DEC__TRIM__M6, CYREG_FLSHID_CUST_TABLES_DEC_M6
.set ADC_DEC__TRIM__M7, CYREG_FLSHID_CUST_TABLES_DEC_M7
.set ADC_DEC__TRIM__M8, CYREG_FLSHID_CUST_TABLES_DEC_M8

/* ADC_DSM */
.set ADC_DSM__BUF0, CYREG_DSM0_BUF0
.set ADC_DSM__BUF1, CYREG_DSM0_BUF1
.set ADC_DSM__BUF2, CYREG_DSM0_BUF2
.set ADC_DSM__BUF3, CYREG_DSM0_BUF3
.set ADC_DSM__CLK, CYREG_DSM0_CLK
.set ADC_DSM__CR0, CYREG_DSM0_CR0
.set ADC_DSM__CR1, CYREG_DSM0_CR1
.set ADC_DSM__CR10, CYREG_DSM0_CR10
.set ADC_DSM__CR11, CYREG_DSM0_CR11
.set ADC_DSM__CR12, CYREG_DSM0_CR12
.set ADC_DSM__CR13, CYREG_DSM0_CR13
.set ADC_DSM__CR14, CYREG_DSM0_CR14
.set ADC_DSM__CR15, CYREG_DSM0_CR15
.set ADC_DSM__CR16, CYREG_DSM0_CR16
.set ADC_DSM__CR17, CYREG_DSM0_CR17
.set ADC_DSM__CR2, CYREG_DSM0_CR2
.set ADC_DSM__CR3, CYREG_DSM0_CR3
.set ADC_DSM__CR4, CYREG_DSM0_CR4
.set ADC_DSM__CR5, CYREG_DSM0_CR5
.set ADC_DSM__CR6, CYREG_DSM0_CR6
.set ADC_DSM__CR7, CYREG_DSM0_CR7
.set ADC_DSM__CR8, CYREG_DSM0_CR8
.set ADC_DSM__CR9, CYREG_DSM0_CR9
.set ADC_DSM__DEM0, CYREG_DSM0_DEM0
.set ADC_DSM__DEM1, CYREG_DSM0_DEM1
.set ADC_DSM__MISC, CYREG_DSM0_MISC
.set ADC_DSM__OUT0, CYREG_DSM0_OUT0
.set ADC_DSM__OUT1, CYREG_DSM0_OUT1
.set ADC_DSM__REF0, CYREG_DSM0_REF0
.set ADC_DSM__REF1, CYREG_DSM0_REF1
.set ADC_DSM__REF2, CYREG_DSM0_REF2
.set ADC_DSM__REF3, CYREG_DSM0_REF3
.set ADC_DSM__RSVD1, CYREG_DSM0_RSVD1
.set ADC_DSM__SW0, CYREG_DSM0_SW0
.set ADC_DSM__SW2, CYREG_DSM0_SW2
.set ADC_DSM__SW3, CYREG_DSM0_SW3
.set ADC_DSM__SW4, CYREG_DSM0_SW4
.set ADC_DSM__SW6, CYREG_DSM0_SW6
.set ADC_DSM__TR0, CYREG_NPUMP_DSM_TR0
.set ADC_DSM__TST0, CYREG_DSM0_TST0
.set ADC_DSM__TST1, CYREG_DSM0_TST1

/* ADC_IRQ */
.set ADC_IRQ__INTC_CLR_EN_REG, CYREG_NVIC_CLRENA0
.set ADC_IRQ__INTC_CLR_PD_REG, CYREG_NVIC_CLRPEND0
.set ADC_IRQ__INTC_MASK, 0x20000000
.set ADC_IRQ__INTC_NUMBER, 29
.set ADC_IRQ__INTC_PRIOR_NUM, 7
.set ADC_IRQ__INTC_PRIOR_REG, CYREG_NVIC_PRI_29
.set ADC_IRQ__INTC_SET_EN_REG, CYREG_NVIC_SETENA0
.set ADC_IRQ__INTC_SET_PD_REG, CYREG_NVIC_SETPEND0

/* PotPin */
.set PotPin__0__MASK, 0x20
.set PotPin__0__PC, CYREG_PRT6_PC5
.set PotPin__0__PORT, 6
.set PotPin__0__SHIFT, 5
.set PotPin__AG, CYREG_PRT6_AG
.set PotPin__AMUX, CYREG_PRT6_AMUX
.set PotPin__BIE, CYREG_PRT6_BIE
.set PotPin__BIT_MASK, CYREG_PRT6_BIT_MASK
.set PotPin__BYP, CYREG_PRT6_BYP
.set PotPin__CTL, CYREG_PRT6_CTL
.set PotPin__DM0, CYREG_PRT6_DM0
.set PotPin__DM1, CYREG_PRT6_DM1
.set PotPin__DM2, CYREG_PRT6_DM2
.set PotPin__DR, CYREG_PRT6_DR
.set PotPin__INP_DIS, CYREG_PRT6_INP_DIS
.set PotPin__LCD_COM_SEG, CYREG_PRT6_LCD_COM_SEG
.set PotPin__LCD_EN, CYREG_PRT6_LCD_EN
.set PotPin__MASK, 0x20
.set PotPin__PORT, 6
.set PotPin__PRT, CYREG_PRT6_PRT
.set PotPin__PRTDSI__CAPS_SEL, CYREG_PRT6_CAPS_SEL
.set PotPin__PRTDSI__DBL_SYNC_IN, CYREG_PRT6_DBL_SYNC_IN
.set PotPin__PRTDSI__OE_SEL0, CYREG_PRT6_OE_SEL0
.set PotPin__PRTDSI__OE_SEL1, CYREG_PRT6_OE_SEL1
.set PotPin__PRTDSI__OUT_SEL0, CYREG_PRT6_OUT_SEL0
.set PotPin__PRTDSI__OUT_SEL1, CYREG_PRT6_OUT_SEL1
.set PotPin__PRTDSI__SYNC_OUT, CYREG_PRT6_SYNC_OUT
.set PotPin__PS, CYREG_PRT6_PS
.set PotPin__SHIFT, 5
.set PotPin__SLW, CYREG_PRT6_SLW

/* LED0 */
.set LED0__0__MASK, 0x01
.set LED0__0__PC, CYREG_PRT5_PC0
.set LED0__0__PORT, 5
.set LED0__0__SHIFT, 0
.set LED0__AG, CYREG_PRT5_AG
.set LED0__AMUX, CYREG_PRT5_AMUX
.set LED0__BIE, CYREG_PRT5_BIE
.set LED0__BIT_MASK, CYREG_PRT5_BIT_MASK
.set LED0__BYP, CYREG_PRT5_BYP
.set LED0__CTL, CYREG_PRT5_CTL
.set LED0__DM0, CYREG_PRT5_DM0
.set LED0__DM1, CYREG_PRT5_DM1
.set LED0__DM2, CYREG_PRT5_DM2
.set LED0__DR, CYREG_PRT5_DR
.set LED0__INP_DIS, CYREG_PRT5_INP_DIS
.set LED0__LCD_COM_SEG, CYREG_PRT5_LCD_COM_SEG
.set LED0__LCD_EN, CYREG_PRT5_LCD_EN
.set LED0__MASK, 0x01
.set LED0__PORT, 5
.set LED0__PRT, CYREG_PRT5_PRT
.set LED0__PRTDSI__CAPS_SEL, CYREG_PRT5_CAPS_SEL
.set LED0__PRTDSI__DBL_SYNC_IN, CYREG_PRT5_DBL_SYNC_IN
.set LED0__PRTDSI__OE_SEL0, CYREG_PRT5_OE_SEL0
.set LED0__PRTDSI__OE_SEL1, CYREG_PRT5_OE_SEL1
.set LED0__PRTDSI__OUT_SEL0, CYREG_PRT5_OUT_SEL0
.set LED0__PRTDSI__OUT_SEL1, CYREG_PRT5_OUT_SEL1
.set LED0__PRTDSI__SYNC_OUT, CYREG_PRT5_SYNC_OUT
.set LED0__PS, CYREG_PRT5_PS
.set LED0__SHIFT, 0
.set LED0__SLW, CYREG_PRT5_SLW

/* LED1 */
.set LED1__0__MASK, 0x01
.set LED1__0__PC, CYREG_PRT12_PC0
.set LED1__0__PORT, 12
.set LED1__0__SHIFT, 0
.set LED1__AG, CYREG_PRT12_AG
.set LED1__BIE, CYREG_PRT12_BIE
.set LED1__BIT_MASK, CYREG_PRT12_BIT_MASK
.set LED1__BYP, CYREG_PRT12_BYP
.set LED1__DM0, CYREG_PRT12_DM0
.set LED1__DM1, CYREG_PRT12_DM1
.set LED1__DM2, CYREG_PRT12_DM2
.set LED1__DR, CYREG_PRT12_DR
.set LED1__INP_DIS, CYREG_PRT12_INP_DIS
.set LED1__MASK, 0x01
.set LED1__PORT, 12
.set LED1__PRT, CYREG_PRT12_PRT
.set LED1__PRTDSI__DBL_SYNC_IN, CYREG_PRT12_DBL_SYNC_IN
.set LED1__PRTDSI__OE_SEL0, CYREG_PRT12_OE_SEL0
.set LED1__PRTDSI__OE_SEL1, CYREG_PRT12_OE_SEL1
.set LED1__PRTDSI__OUT_SEL0, CYREG_PRT12_OUT_SEL0
.set LED1__PRTDSI__OUT_SEL1, CYREG_PRT12_OUT_SEL1
.set LED1__PRTDSI__SYNC_OUT, CYREG_PRT12_SYNC_OUT
.set LED1__PS, CYREG_PRT12_PS
.set LED1__SHIFT, 0
.set LED1__SIO_CFG, CYREG_PRT12_SIO_CFG
.set LED1__SIO_DIFF, CYREG_PRT12_SIO_DIFF
.set LED1__SIO_HYST_EN, CYREG_PRT12_SIO_HYST_EN
.set LED1__SIO_REG_HIFREQ, CYREG_PRT12_SIO_REG_HIFREQ
.set LED1__SLW, CYREG_PRT12_SLW

/* LED2 */
.set LED2__0__MASK, 0x08
.set LED2__0__PC, CYREG_PRT12_PC3
.set LED2__0__PORT, 12
.set LED2__0__SHIFT, 3
.set LED2__AG, CYREG_PRT12_AG
.set LED2__BIE, CYREG_PRT12_BIE
.set LED2__BIT_MASK, CYREG_PRT12_BIT_MASK
.set LED2__BYP, CYREG_PRT12_BYP
.set LED2__DM0, CYREG_PRT12_DM0
.set LED2__DM1, CYREG_PRT12_DM1
.set LED2__DM2, CYREG_PRT12_DM2
.set LED2__DR, CYREG_PRT12_DR
.set LED2__INP_DIS, CYREG_PRT12_INP_DIS
.set LED2__MASK, 0x08
.set LED2__PORT, 12
.set LED2__PRT, CYREG_PRT12_PRT
.set LED2__PRTDSI__DBL_SYNC_IN, CYREG_PRT12_DBL_SYNC_IN
.set LED2__PRTDSI__OE_SEL0, CYREG_PRT12_OE_SEL0
.set LED2__PRTDSI__OE_SEL1, CYREG_PRT12_OE_SEL1
.set LED2__PRTDSI__OUT_SEL0, CYREG_PRT12_OUT_SEL0
.set LED2__PRTDSI__OUT_SEL1, CYREG_PRT12_OUT_SEL1
.set LED2__PRTDSI__SYNC_OUT, CYREG_PRT12_SYNC_OUT
.set LED2__PS, CYREG_PRT12_PS
.set LED2__SHIFT, 3
.set LED2__SIO_CFG, CYREG_PRT12_SIO_CFG
.set LED2__SIO_DIFF, CYREG_PRT12_SIO_DIFF
.set LED2__SIO_HYST_EN, CYREG_PRT12_SIO_HYST_EN
.set LED2__SIO_REG_HIFREQ, CYREG_PRT12_SIO_REG_HIFREQ
.set LED2__SLW, CYREG_PRT12_SLW

/* LED3 */
.set LED3__0__MASK, 0x02
.set LED3__0__PC, CYREG_PRT12_PC1
.set LED3__0__PORT, 12
.set LED3__0__SHIFT, 1
.set LED3__AG, CYREG_PRT12_AG
.set LED3__BIE, CYREG_PRT12_BIE
.set LED3__BIT_MASK, CYREG_PRT12_BIT_MASK
.set LED3__BYP, CYREG_PRT12_BYP
.set LED3__DM0, CYREG_PRT12_DM0
.set LED3__DM1, CYREG_PRT12_DM1
.set LED3__DM2, CYREG_PRT12_DM2
.set LED3__DR, CYREG_PRT12_DR
.set LED3__INP_DIS, CYREG_PRT12_INP_DIS
.set LED3__MASK, 0x02
.set LED3__PORT, 12
.set LED3__PRT, CYREG_PRT12_PRT
.set LED3__PRTDSI__DBL_SYNC_IN, CYREG_PRT12_DBL_SYNC_IN
.set LED3__PRTDSI__OE_SEL0, CYREG_PRT12_OE_SEL0
.set LED3__PRTDSI__OE_SEL1, CYREG_PRT12_OE_SEL1
.set LED3__PRTDSI__OUT_SEL0, CYREG_PRT12_OUT_SEL0
.set LED3__PRTDSI__OUT_SEL1, CYREG_PRT12_OUT_SEL1
.set LED3__PRTDSI__SYNC_OUT, CYREG_PRT12_SYNC_OUT
.set LED3__PS, CYREG_PRT12_PS
.set LED3__SHIFT, 1
.set LED3__SIO_CFG, CYREG_PRT12_SIO_CFG
.set LED3__SIO_DIFF, CYREG_PRT12_SIO_DIFF
.set LED3__SIO_HYST_EN, CYREG_PRT12_SIO_HYST_EN
.set LED3__SIO_REG_HIFREQ, CYREG_PRT12_SIO_REG_HIFREQ
.set LED3__SLW, CYREG_PRT12_SLW

/* LED4 */
.set LED4__0__MASK, 0x04
.set LED4__0__PC, CYREG_PRT12_PC2
.set LED4__0__PORT, 12
.set LED4__0__SHIFT, 2
.set LED4__AG, CYREG_PRT12_AG
.set LED4__BIE, CYREG_PRT12_BIE
.set LED4__BIT_MASK, CYREG_PRT12_BIT_MASK
.set LED4__BYP, CYREG_PRT12_BYP
.set LED4__DM0, CYREG_PRT12_DM0
.set LED4__DM1, CYREG_PRT12_DM1
.set LED4__DM2, CYREG_PRT12_DM2
.set LED4__DR, CYREG_PRT12_DR
.set LED4__INP_DIS, CYREG_PRT12_INP_DIS
.set LED4__MASK, 0x04
.set LED4__PORT, 12
.set LED4__PRT, CYREG_PRT12_PRT
.set LED4__PRTDSI__DBL_SYNC_IN, CYREG_PRT12_DBL_SYNC_IN
.set LED4__PRTDSI__OE_SEL0, CYREG_PRT12_OE_SEL0
.set LED4__PRTDSI__OE_SEL1, CYREG_PRT12_OE_SEL1
.set LED4__PRTDSI__OUT_SEL0, CYREG_PRT12_OUT_SEL0
.set LED4__PRTDSI__OUT_SEL1, CYREG_PRT12_OUT_SEL1
.set LED4__PRTDSI__SYNC_OUT, CYREG_PRT12_SYNC_OUT
.set LED4__PS, CYREG_PRT12_PS
.set LED4__SHIFT, 2
.set LED4__SIO_CFG, CYREG_PRT12_SIO_CFG
.set LED4__SIO_DIFF, CYREG_PRT12_SIO_DIFF
.set LED4__SIO_HYST_EN, CYREG_PRT12_SIO_HYST_EN
.set LED4__SIO_REG_HIFREQ, CYREG_PRT12_SIO_REG_HIFREQ
.set LED4__SLW, CYREG_PRT12_SLW

/* LED5 */
.set LED5__0__MASK, 0x02
.set LED5__0__PC, CYREG_PRT5_PC1
.set LED5__0__PORT, 5
.set LED5__0__SHIFT, 1
.set LED5__AG, CYREG_PRT5_AG
.set LED5__AMUX, CYREG_PRT5_AMUX
.set LED5__BIE, CYREG_PRT5_BIE
.set LED5__BIT_MASK, CYREG_PRT5_BIT_MASK
.set LED5__BYP, CYREG_PRT5_BYP
.set LED5__CTL, CYREG_PRT5_CTL
.set LED5__DM0, CYREG_PRT5_DM0
.set LED5__DM1, CYREG_PRT5_DM1
.set LED5__DM2, CYREG_PRT5_DM2
.set LED5__DR, CYREG_PRT5_DR
.set LED5__INP_DIS, CYREG_PRT5_INP_DIS
.set LED5__LCD_COM_SEG, CYREG_PRT5_LCD_COM_SEG
.set LED5__LCD_EN, CYREG_PRT5_LCD_EN
.set LED5__MASK, 0x02
.set LED5__PORT, 5
.set LED5__PRT, CYREG_PRT5_PRT
.set LED5__PRTDSI__CAPS_SEL, CYREG_PRT5_CAPS_SEL
.set LED5__PRTDSI__DBL_SYNC_IN, CYREG_PRT5_DBL_SYNC_IN
.set LED5__PRTDSI__OE_SEL0, CYREG_PRT5_OE_SEL0
.set LED5__PRTDSI__OE_SEL1, CYREG_PRT5_OE_SEL1
.set LED5__PRTDSI__OUT_SEL0, CYREG_PRT5_OUT_SEL0
.set LED5__PRTDSI__OUT_SEL1, CYREG_PRT5_OUT_SEL1
.set LED5__PRTDSI__SYNC_OUT, CYREG_PRT5_SYNC_OUT
.set LED5__PS, CYREG_PRT5_PS
.set LED5__SHIFT, 1
.set LED5__SLW, CYREG_PRT5_SLW

/* LED6 */
.set LED6__0__MASK, 0x04
.set LED6__0__PC, CYREG_PRT5_PC2
.set LED6__0__PORT, 5
.set LED6__0__SHIFT, 2
.set LED6__AG, CYREG_PRT5_AG
.set LED6__AMUX, CYREG_PRT5_AMUX
.set LED6__BIE, CYREG_PRT5_BIE
.set LED6__BIT_MASK, CYREG_PRT5_BIT_MASK
.set LED6__BYP, CYREG_PRT5_BYP
.set LED6__CTL, CYREG_PRT5_CTL
.set LED6__DM0, CYREG_PRT5_DM0
.set LED6__DM1, CYREG_PRT5_DM1
.set LED6__DM2, CYREG_PRT5_DM2
.set LED6__DR, CYREG_PRT5_DR
.set LED6__INP_DIS, CYREG_PRT5_INP_DIS
.set LED6__LCD_COM_SEG, CYREG_PRT5_LCD_COM_SEG
.set LED6__LCD_EN, CYREG_PRT5_LCD_EN
.set LED6__MASK, 0x04
.set LED6__PORT, 5
.set LED6__PRT, CYREG_PRT5_PRT
.set LED6__PRTDSI__CAPS_SEL, CYREG_PRT5_CAPS_SEL
.set LED6__PRTDSI__DBL_SYNC_IN, CYREG_PRT5_DBL_SYNC_IN
.set LED6__PRTDSI__OE_SEL0, CYREG_PRT5_OE_SEL0
.set LED6__PRTDSI__OE_SEL1, CYREG_PRT5_OE_SEL1
.set LED6__PRTDSI__OUT_SEL0, CYREG_PRT5_OUT_SEL0
.set LED6__PRTDSI__OUT_SEL1, CYREG_PRT5_OUT_SEL1
.set LED6__PRTDSI__SYNC_OUT, CYREG_PRT5_SYNC_OUT
.set LED6__PS, CYREG_PRT5_PS
.set LED6__SHIFT, 2
.set LED6__SLW, CYREG_PRT5_SLW

/* LED7 */
.set LED7__0__MASK, 0x08
.set LED7__0__PC, CYREG_PRT5_PC3
.set LED7__0__PORT, 5
.set LED7__0__SHIFT, 3
.set LED7__AG, CYREG_PRT5_AG
.set LED7__AMUX, CYREG_PRT5_AMUX
.set LED7__BIE, CYREG_PRT5_BIE
.set LED7__BIT_MASK, CYREG_PRT5_BIT_MASK
.set LED7__BYP, CYREG_PRT5_BYP
.set LED7__CTL, CYREG_PRT5_CTL
.set LED7__DM0, CYREG_PRT5_DM0
.set LED7__DM1, CYREG_PRT5_DM1
.set LED7__DM2, CYREG_PRT5_DM2
.set LED7__DR, CYREG_PRT5_DR
.set LED7__INP_DIS, CYREG_PRT5_INP_DIS
.set LED7__LCD_COM_SEG, CYREG_PRT5_LCD_COM_SEG
.set LED7__LCD_EN, CYREG_PRT5_LCD_EN
.set LED7__MASK, 0x08
.set LED7__PORT, 5
.set LED7__PRT, CYREG_PRT5_PRT
.set LED7__PRTDSI__CAPS_SEL, CYREG_PRT5_CAPS_SEL
.set LED7__PRTDSI__DBL_SYNC_IN, CYREG_PRT5_DBL_SYNC_IN
.set LED7__PRTDSI__OE_SEL0, CYREG_PRT5_OE_SEL0
.set LED7__PRTDSI__OE_SEL1, CYREG_PRT5_OE_SEL1
.set LED7__PRTDSI__OUT_SEL0, CYREG_PRT5_OUT_SEL0
.set LED7__PRTDSI__OUT_SEL1, CYREG_PRT5_OUT_SEL1
.set LED7__PRTDSI__SYNC_OUT, CYREG_PRT5_SYNC_OUT
.set LED7__PS, CYREG_PRT5_PS
.set LED7__SHIFT, 3
.set LED7__SLW, CYREG_PRT5_SLW

/* Miscellaneous */
/* -- WARNING: define names containing LEOPARD or PANTHER are deprecated and will be removed in a future release */
.set CYDEV_DEBUGGING_DPS_SWD_SWV, 6
.set CYDEV_CONFIG_UNUSED_IO_AllowButWarn, 0
.set CYDEV_CONFIGURATION_MODE_COMPRESSED, 0
.set CYDEV_CONFIG_FASTBOOT_ENABLED, 1
.set CYDEV_CHIP_REV_PSOC5LP_PRODUCTION, 0
.set CYDEV_CHIP_REVISION_5B_PRODUCTION, 0
.set CYDEV_CHIP_MEMBER_5B, 4
.set CYDEV_CHIP_FAMILY_PSOC5, 3
.set CYDEV_CHIP_DIE_PSOC5LP, 4
.set CYDEV_CHIP_DIE_EXPECT, CYDEV_CHIP_DIE_PSOC5LP
.set BCLK__BUS_CLK__HZ, 24000000
.set BCLK__BUS_CLK__KHZ, 24000
.set BCLK__BUS_CLK__MHZ, 24
.set CYDEV_CHIP_DIE_ACTUAL, CYDEV_CHIP_DIE_EXPECT
.set CYDEV_CHIP_DIE_LEOPARD, 1
.set CYDEV_CHIP_DIE_PANTHER, 3
.set CYDEV_CHIP_DIE_PSOC4A, 2
.set CYDEV_CHIP_DIE_UNKNOWN, 0
.set CYDEV_CHIP_FAMILY_PSOC3, 1
.set CYDEV_CHIP_FAMILY_PSOC4, 2
.set CYDEV_CHIP_FAMILY_UNKNOWN, 0
.set CYDEV_CHIP_FAMILY_USED, CYDEV_CHIP_FAMILY_PSOC5
.set CYDEV_CHIP_JTAG_ID, 0x2E123069
.set CYDEV_CHIP_MEMBER_3A, 1
.set CYDEV_CHIP_MEMBER_4A, 2
.set CYDEV_CHIP_MEMBER_5A, 3
.set CYDEV_CHIP_MEMBER_UNKNOWN, 0
.set CYDEV_CHIP_MEMBER_USED, CYDEV_CHIP_MEMBER_5B
.set CYDEV_CHIP_REVISION_3A_ES1, 0
.set CYDEV_CHIP_REVISION_3A_ES2, 1
.set CYDEV_CHIP_REVISION_3A_ES3, 3
.set CYDEV_CHIP_REVISION_3A_PRODUCTION, 3
.set CYDEV_CHIP_REVISION_4A_ES0, 17
.set CYDEV_CHIP_REVISION_4A_PRODUCTION, 17
.set CYDEV_CHIP_REVISION_5A_ES0, 0
.set CYDEV_CHIP_REVISION_5A_ES1, 1
.set CYDEV_CHIP_REVISION_5A_PRODUCTION, 1
.set CYDEV_CHIP_REVISION_5B_ES0, 0
.set CYDEV_CHIP_REVISION_USED, CYDEV_CHIP_REVISION_5B_PRODUCTION
.set CYDEV_CHIP_REV_EXPECT, CYDEV_CHIP_REV_PSOC5LP_PRODUCTION
.set CYDEV_CHIP_REV_LEOPARD_ES1, 0
.set CYDEV_CHIP_REV_LEOPARD_ES2, 1
.set CYDEV_CHIP_REV_LEOPARD_ES3, 3
.set CYDEV_CHIP_REV_LEOPARD_PRODUCTION, 3
.set CYDEV_CHIP_REV_PANTHER_ES0, 0
.set CYDEV_CHIP_REV_PANTHER_ES1, 1
.set CYDEV_CHIP_REV_PANTHER_PRODUCTION, 1
.set CYDEV_CHIP_REV_PSOC4A_ES0, 17
.set CYDEV_CHIP_REV_PSOC4A_PRODUCTION, 17
.set CYDEV_CHIP_REV_PSOC5LP_ES0, 0
.set CYDEV_CONFIGURATION_COMPRESSED, 1
.set CYDEV_CONFIGURATION_DMA, 0
.set CYDEV_CONFIGURATION_ECC, 1
.set CYDEV_CONFIGURATION_IMOENABLED, CYDEV_CONFIG_FASTBOOT_ENABLED
.set CYDEV_CONFIGURATION_MODE, CYDEV_CONFIGURATION_MODE_COMPRESSED
.set CYDEV_CONFIGURATION_MODE_DMA, 2
.set CYDEV_CONFIGURATION_MODE_UNCOMPRESSED, 1
.set CYDEV_CONFIG_UNUSED_IO, CYDEV_CONFIG_UNUSED_IO_AllowButWarn
.set CYDEV_CONFIG_UNUSED_IO_AllowWithInfo, 1
.set CYDEV_CONFIG_UNUSED_IO_Disallowed, 2
.set CYDEV_DEBUGGING_DPS, CYDEV_DEBUGGING_DPS_SWD_SWV
.set CYDEV_DEBUGGING_DPS_Disable, 3
.set CYDEV_DEBUGGING_DPS_JTAG_4, 1
.set CYDEV_DEBUGGING_DPS_JTAG_5, 0
.set CYDEV_DEBUGGING_DPS_SWD, 2
.set CYDEV_DEBUGGING_ENABLE, 1
.set CYDEV_DEBUGGING_XRES, 0
.set CYDEV_DEBUG_ENABLE_MASK, 0x20
.set CYDEV_DEBUG_ENABLE_REGISTER, CYREG_MLOGIC_DEBUG
.set CYDEV_DMA_CHANNELS_AVAILABLE, 24
.set CYDEV_ECC_ENABLE, 0
.set CYDEV_HEAP_SIZE, 0x1000
.set CYDEV_INSTRUCT_CACHE_ENABLED, 1
.set CYDEV_INTR_RISING, 0x00000000
.set CYDEV_PROJ_TYPE, 0
.set CYDEV_PROJ_TYPE_BOOTLOADER, 1
.set CYDEV_PROJ_TYPE_LOADABLE, 2
.set CYDEV_PROJ_TYPE_MULTIAPPBOOTLOADER, 3
.set CYDEV_PROJ_TYPE_STANDARD, 0
.set CYDEV_PROTECTION_ENABLE, 0
.set CYDEV_STACK_SIZE, 0x4000
.set CYDEV_USE_BUNDLED_CMSIS, 1
.set CYDEV_VARIABLE_VDDA, 0
.set CYDEV_VDDA_MV, 5000
.set CYDEV_VDDD_MV, 5000
.set CYDEV_VDDIO0_MV, 5000
.set CYDEV_VDDIO1_MV, 5000
.set CYDEV_VDDIO2_MV, 5000
.set CYDEV_VDDIO3_MV, 5000
.set CYDEV_VIO0, 5
.set CYDEV_VIO0_MV, 5000
.set CYDEV_VIO1, 5
.set CYDEV_VIO1_MV, 5000
.set CYDEV_VIO2, 5
.set CYDEV_VIO2_MV, 5000
.set CYDEV_VIO3, 5
.set CYDEV_VIO3_MV, 5000
.set DMA_CHANNELS_USED__MASK0, 0x00000000
.set CYDEV_BOOTLOADER_ENABLE, 0
.endif
