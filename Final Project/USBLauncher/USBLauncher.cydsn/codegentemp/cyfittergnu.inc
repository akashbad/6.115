.ifndef INCLUDED_CYFITTERGNU_INC
.set INCLUDED_CYFITTERGNU_INC, 1
.include "cydevicegnu.inc"
.include "cydevicegnu_trm.inc"

/* USBFS_1_bus_reset */
.set USBFS_1_bus_reset__INTC_CLR_EN_REG, CYREG_NVIC_CLRENA0
.set USBFS_1_bus_reset__INTC_CLR_PD_REG, CYREG_NVIC_CLRPEND0
.set USBFS_1_bus_reset__INTC_MASK, 0x800000
.set USBFS_1_bus_reset__INTC_NUMBER, 23
.set USBFS_1_bus_reset__INTC_PRIOR_NUM, 7
.set USBFS_1_bus_reset__INTC_PRIOR_REG, CYREG_NVIC_PRI_23
.set USBFS_1_bus_reset__INTC_SET_EN_REG, CYREG_NVIC_SETENA0
.set USBFS_1_bus_reset__INTC_SET_PD_REG, CYREG_NVIC_SETPEND0

/* USBFS_1_arb_int */
.set USBFS_1_arb_int__INTC_CLR_EN_REG, CYREG_NVIC_CLRENA0
.set USBFS_1_arb_int__INTC_CLR_PD_REG, CYREG_NVIC_CLRPEND0
.set USBFS_1_arb_int__INTC_MASK, 0x400000
.set USBFS_1_arb_int__INTC_NUMBER, 22
.set USBFS_1_arb_int__INTC_PRIOR_NUM, 7
.set USBFS_1_arb_int__INTC_PRIOR_REG, CYREG_NVIC_PRI_22
.set USBFS_1_arb_int__INTC_SET_EN_REG, CYREG_NVIC_SETENA0
.set USBFS_1_arb_int__INTC_SET_PD_REG, CYREG_NVIC_SETPEND0

/* USBFS_1_sof_int */
.set USBFS_1_sof_int__INTC_CLR_EN_REG, CYREG_NVIC_CLRENA0
.set USBFS_1_sof_int__INTC_CLR_PD_REG, CYREG_NVIC_CLRPEND0
.set USBFS_1_sof_int__INTC_MASK, 0x200000
.set USBFS_1_sof_int__INTC_NUMBER, 21
.set USBFS_1_sof_int__INTC_PRIOR_NUM, 7
.set USBFS_1_sof_int__INTC_PRIOR_REG, CYREG_NVIC_PRI_21
.set USBFS_1_sof_int__INTC_SET_EN_REG, CYREG_NVIC_SETENA0
.set USBFS_1_sof_int__INTC_SET_PD_REG, CYREG_NVIC_SETPEND0

/* ADC_Ext_CP_Clk */
.set ADC_Ext_CP_Clk__CFG0, CYREG_CLKDIST_DCFG0_CFG0
.set ADC_Ext_CP_Clk__CFG1, CYREG_CLKDIST_DCFG0_CFG1
.set ADC_Ext_CP_Clk__CFG2, CYREG_CLKDIST_DCFG0_CFG2
.set ADC_Ext_CP_Clk__CFG2_SRC_SEL_MASK, 0x07
.set ADC_Ext_CP_Clk__INDEX, 0x00
.set ADC_Ext_CP_Clk__PM_ACT_CFG, CYREG_PM_ACT_CFG2
.set ADC_Ext_CP_Clk__PM_ACT_MSK, 0x01
.set ADC_Ext_CP_Clk__PM_STBY_CFG, CYREG_PM_STBY_CFG2
.set ADC_Ext_CP_Clk__PM_STBY_MSK, 0x01

/* USBFS_1_dp_int */
.set USBFS_1_dp_int__INTC_CLR_EN_REG, CYREG_NVIC_CLRENA0
.set USBFS_1_dp_int__INTC_CLR_PD_REG, CYREG_NVIC_CLRPEND0
.set USBFS_1_dp_int__INTC_MASK, 0x1000
.set USBFS_1_dp_int__INTC_NUMBER, 12
.set USBFS_1_dp_int__INTC_PRIOR_NUM, 7
.set USBFS_1_dp_int__INTC_PRIOR_REG, CYREG_NVIC_PRI_12
.set USBFS_1_dp_int__INTC_SET_EN_REG, CYREG_NVIC_SETENA0
.set USBFS_1_dp_int__INTC_SET_PD_REG, CYREG_NVIC_SETPEND0

/* USBFS_1_ep_0 */
.set USBFS_1_ep_0__INTC_CLR_EN_REG, CYREG_NVIC_CLRENA0
.set USBFS_1_ep_0__INTC_CLR_PD_REG, CYREG_NVIC_CLRPEND0
.set USBFS_1_ep_0__INTC_MASK, 0x1000000
.set USBFS_1_ep_0__INTC_NUMBER, 24
.set USBFS_1_ep_0__INTC_PRIOR_NUM, 7
.set USBFS_1_ep_0__INTC_PRIOR_REG, CYREG_NVIC_PRI_24
.set USBFS_1_ep_0__INTC_SET_EN_REG, CYREG_NVIC_SETENA0
.set USBFS_1_ep_0__INTC_SET_PD_REG, CYREG_NVIC_SETPEND0

/* USBFS_1_ep_1 */
.set USBFS_1_ep_1__INTC_CLR_EN_REG, CYREG_NVIC_CLRENA0
.set USBFS_1_ep_1__INTC_CLR_PD_REG, CYREG_NVIC_CLRPEND0
.set USBFS_1_ep_1__INTC_MASK, 0x01
.set USBFS_1_ep_1__INTC_NUMBER, 0
.set USBFS_1_ep_1__INTC_PRIOR_NUM, 7
.set USBFS_1_ep_1__INTC_PRIOR_REG, CYREG_NVIC_PRI_0
.set USBFS_1_ep_1__INTC_SET_EN_REG, CYREG_NVIC_SETENA0
.set USBFS_1_ep_1__INTC_SET_PD_REG, CYREG_NVIC_SETPEND0

/* ADC_theACLK */
.set ADC_theACLK__CFG0, CYREG_CLKDIST_ACFG0_CFG0
.set ADC_theACLK__CFG1, CYREG_CLKDIST_ACFG0_CFG1
.set ADC_theACLK__CFG2, CYREG_CLKDIST_ACFG0_CFG2
.set ADC_theACLK__CFG2_SRC_SEL_MASK, 0x07
.set ADC_theACLK__CFG3, CYREG_CLKDIST_ACFG0_CFG3
.set ADC_theACLK__CFG3_PHASE_DLY_MASK, 0x0F
.set ADC_theACLK__INDEX, 0x00
.set ADC_theACLK__PM_ACT_CFG, CYREG_PM_ACT_CFG1
.set ADC_theACLK__PM_ACT_MSK, 0x01
.set ADC_theACLK__PM_STBY_CFG, CYREG_PM_STBY_CFG1
.set ADC_theACLK__PM_STBY_MSK, 0x01

/* LCD_LCDPort */
.set LCD_LCDPort__0__MASK, 0x01
.set LCD_LCDPort__0__PC, CYREG_PRT2_PC0
.set LCD_LCDPort__0__PORT, 2
.set LCD_LCDPort__0__SHIFT, 0
.set LCD_LCDPort__1__MASK, 0x02
.set LCD_LCDPort__1__PC, CYREG_PRT2_PC1
.set LCD_LCDPort__1__PORT, 2
.set LCD_LCDPort__1__SHIFT, 1
.set LCD_LCDPort__2__MASK, 0x04
.set LCD_LCDPort__2__PC, CYREG_PRT2_PC2
.set LCD_LCDPort__2__PORT, 2
.set LCD_LCDPort__2__SHIFT, 2
.set LCD_LCDPort__3__MASK, 0x08
.set LCD_LCDPort__3__PC, CYREG_PRT2_PC3
.set LCD_LCDPort__3__PORT, 2
.set LCD_LCDPort__3__SHIFT, 3
.set LCD_LCDPort__4__MASK, 0x10
.set LCD_LCDPort__4__PC, CYREG_PRT2_PC4
.set LCD_LCDPort__4__PORT, 2
.set LCD_LCDPort__4__SHIFT, 4
.set LCD_LCDPort__5__MASK, 0x20
.set LCD_LCDPort__5__PC, CYREG_PRT2_PC5
.set LCD_LCDPort__5__PORT, 2
.set LCD_LCDPort__5__SHIFT, 5
.set LCD_LCDPort__6__MASK, 0x40
.set LCD_LCDPort__6__PC, CYREG_PRT2_PC6
.set LCD_LCDPort__6__PORT, 2
.set LCD_LCDPort__6__SHIFT, 6
.set LCD_LCDPort__AG, CYREG_PRT2_AG
.set LCD_LCDPort__AMUX, CYREG_PRT2_AMUX
.set LCD_LCDPort__BIE, CYREG_PRT2_BIE
.set LCD_LCDPort__BIT_MASK, CYREG_PRT2_BIT_MASK
.set LCD_LCDPort__BYP, CYREG_PRT2_BYP
.set LCD_LCDPort__CTL, CYREG_PRT2_CTL
.set LCD_LCDPort__DM0, CYREG_PRT2_DM0
.set LCD_LCDPort__DM1, CYREG_PRT2_DM1
.set LCD_LCDPort__DM2, CYREG_PRT2_DM2
.set LCD_LCDPort__DR, CYREG_PRT2_DR
.set LCD_LCDPort__INP_DIS, CYREG_PRT2_INP_DIS
.set LCD_LCDPort__LCD_COM_SEG, CYREG_PRT2_LCD_COM_SEG
.set LCD_LCDPort__LCD_EN, CYREG_PRT2_LCD_EN
.set LCD_LCDPort__MASK, 0x7F
.set LCD_LCDPort__PORT, 2
.set LCD_LCDPort__PRT, CYREG_PRT2_PRT
.set LCD_LCDPort__PRTDSI__CAPS_SEL, CYREG_PRT2_CAPS_SEL
.set LCD_LCDPort__PRTDSI__DBL_SYNC_IN, CYREG_PRT2_DBL_SYNC_IN
.set LCD_LCDPort__PRTDSI__OE_SEL0, CYREG_PRT2_OE_SEL0
.set LCD_LCDPort__PRTDSI__OE_SEL1, CYREG_PRT2_OE_SEL1
.set LCD_LCDPort__PRTDSI__OUT_SEL0, CYREG_PRT2_OUT_SEL0
.set LCD_LCDPort__PRTDSI__OUT_SEL1, CYREG_PRT2_OUT_SEL1
.set LCD_LCDPort__PRTDSI__SYNC_OUT, CYREG_PRT2_SYNC_OUT
.set LCD_LCDPort__PS, CYREG_PRT2_PS
.set LCD_LCDPort__SHIFT, 0
.set LCD_LCDPort__SLW, CYREG_PRT2_SLW

/* USBFS_1_USB */
.set USBFS_1_USB__ARB_CFG, CYREG_USB_ARB_CFG
.set USBFS_1_USB__ARB_EP1_CFG, CYREG_USB_ARB_EP1_CFG
.set USBFS_1_USB__ARB_EP1_INT_EN, CYREG_USB_ARB_EP1_INT_EN
.set USBFS_1_USB__ARB_EP1_SR, CYREG_USB_ARB_EP1_SR
.set USBFS_1_USB__ARB_EP2_CFG, CYREG_USB_ARB_EP2_CFG
.set USBFS_1_USB__ARB_EP2_INT_EN, CYREG_USB_ARB_EP2_INT_EN
.set USBFS_1_USB__ARB_EP2_SR, CYREG_USB_ARB_EP2_SR
.set USBFS_1_USB__ARB_EP3_CFG, CYREG_USB_ARB_EP3_CFG
.set USBFS_1_USB__ARB_EP3_INT_EN, CYREG_USB_ARB_EP3_INT_EN
.set USBFS_1_USB__ARB_EP3_SR, CYREG_USB_ARB_EP3_SR
.set USBFS_1_USB__ARB_EP4_CFG, CYREG_USB_ARB_EP4_CFG
.set USBFS_1_USB__ARB_EP4_INT_EN, CYREG_USB_ARB_EP4_INT_EN
.set USBFS_1_USB__ARB_EP4_SR, CYREG_USB_ARB_EP4_SR
.set USBFS_1_USB__ARB_EP5_CFG, CYREG_USB_ARB_EP5_CFG
.set USBFS_1_USB__ARB_EP5_INT_EN, CYREG_USB_ARB_EP5_INT_EN
.set USBFS_1_USB__ARB_EP5_SR, CYREG_USB_ARB_EP5_SR
.set USBFS_1_USB__ARB_EP6_CFG, CYREG_USB_ARB_EP6_CFG
.set USBFS_1_USB__ARB_EP6_INT_EN, CYREG_USB_ARB_EP6_INT_EN
.set USBFS_1_USB__ARB_EP6_SR, CYREG_USB_ARB_EP6_SR
.set USBFS_1_USB__ARB_EP7_CFG, CYREG_USB_ARB_EP7_CFG
.set USBFS_1_USB__ARB_EP7_INT_EN, CYREG_USB_ARB_EP7_INT_EN
.set USBFS_1_USB__ARB_EP7_SR, CYREG_USB_ARB_EP7_SR
.set USBFS_1_USB__ARB_EP8_CFG, CYREG_USB_ARB_EP8_CFG
.set USBFS_1_USB__ARB_EP8_INT_EN, CYREG_USB_ARB_EP8_INT_EN
.set USBFS_1_USB__ARB_EP8_SR, CYREG_USB_ARB_EP8_SR
.set USBFS_1_USB__ARB_INT_EN, CYREG_USB_ARB_INT_EN
.set USBFS_1_USB__ARB_INT_SR, CYREG_USB_ARB_INT_SR
.set USBFS_1_USB__ARB_RW1_DR, CYREG_USB_ARB_RW1_DR
.set USBFS_1_USB__ARB_RW1_RA, CYREG_USB_ARB_RW1_RA
.set USBFS_1_USB__ARB_RW1_RA_MSB, CYREG_USB_ARB_RW1_RA_MSB
.set USBFS_1_USB__ARB_RW1_WA, CYREG_USB_ARB_RW1_WA
.set USBFS_1_USB__ARB_RW1_WA_MSB, CYREG_USB_ARB_RW1_WA_MSB
.set USBFS_1_USB__ARB_RW2_DR, CYREG_USB_ARB_RW2_DR
.set USBFS_1_USB__ARB_RW2_RA, CYREG_USB_ARB_RW2_RA
.set USBFS_1_USB__ARB_RW2_RA_MSB, CYREG_USB_ARB_RW2_RA_MSB
.set USBFS_1_USB__ARB_RW2_WA, CYREG_USB_ARB_RW2_WA
.set USBFS_1_USB__ARB_RW2_WA_MSB, CYREG_USB_ARB_RW2_WA_MSB
.set USBFS_1_USB__ARB_RW3_DR, CYREG_USB_ARB_RW3_DR
.set USBFS_1_USB__ARB_RW3_RA, CYREG_USB_ARB_RW3_RA
.set USBFS_1_USB__ARB_RW3_RA_MSB, CYREG_USB_ARB_RW3_RA_MSB
.set USBFS_1_USB__ARB_RW3_WA, CYREG_USB_ARB_RW3_WA
.set USBFS_1_USB__ARB_RW3_WA_MSB, CYREG_USB_ARB_RW3_WA_MSB
.set USBFS_1_USB__ARB_RW4_DR, CYREG_USB_ARB_RW4_DR
.set USBFS_1_USB__ARB_RW4_RA, CYREG_USB_ARB_RW4_RA
.set USBFS_1_USB__ARB_RW4_RA_MSB, CYREG_USB_ARB_RW4_RA_MSB
.set USBFS_1_USB__ARB_RW4_WA, CYREG_USB_ARB_RW4_WA
.set USBFS_1_USB__ARB_RW4_WA_MSB, CYREG_USB_ARB_RW4_WA_MSB
.set USBFS_1_USB__ARB_RW5_DR, CYREG_USB_ARB_RW5_DR
.set USBFS_1_USB__ARB_RW5_RA, CYREG_USB_ARB_RW5_RA
.set USBFS_1_USB__ARB_RW5_RA_MSB, CYREG_USB_ARB_RW5_RA_MSB
.set USBFS_1_USB__ARB_RW5_WA, CYREG_USB_ARB_RW5_WA
.set USBFS_1_USB__ARB_RW5_WA_MSB, CYREG_USB_ARB_RW5_WA_MSB
.set USBFS_1_USB__ARB_RW6_DR, CYREG_USB_ARB_RW6_DR
.set USBFS_1_USB__ARB_RW6_RA, CYREG_USB_ARB_RW6_RA
.set USBFS_1_USB__ARB_RW6_RA_MSB, CYREG_USB_ARB_RW6_RA_MSB
.set USBFS_1_USB__ARB_RW6_WA, CYREG_USB_ARB_RW6_WA
.set USBFS_1_USB__ARB_RW6_WA_MSB, CYREG_USB_ARB_RW6_WA_MSB
.set USBFS_1_USB__ARB_RW7_DR, CYREG_USB_ARB_RW7_DR
.set USBFS_1_USB__ARB_RW7_RA, CYREG_USB_ARB_RW7_RA
.set USBFS_1_USB__ARB_RW7_RA_MSB, CYREG_USB_ARB_RW7_RA_MSB
.set USBFS_1_USB__ARB_RW7_WA, CYREG_USB_ARB_RW7_WA
.set USBFS_1_USB__ARB_RW7_WA_MSB, CYREG_USB_ARB_RW7_WA_MSB
.set USBFS_1_USB__ARB_RW8_DR, CYREG_USB_ARB_RW8_DR
.set USBFS_1_USB__ARB_RW8_RA, CYREG_USB_ARB_RW8_RA
.set USBFS_1_USB__ARB_RW8_RA_MSB, CYREG_USB_ARB_RW8_RA_MSB
.set USBFS_1_USB__ARB_RW8_WA, CYREG_USB_ARB_RW8_WA
.set USBFS_1_USB__ARB_RW8_WA_MSB, CYREG_USB_ARB_RW8_WA_MSB
.set USBFS_1_USB__BUF_SIZE, CYREG_USB_BUF_SIZE
.set USBFS_1_USB__BUS_RST_CNT, CYREG_USB_BUS_RST_CNT
.set USBFS_1_USB__CR0, CYREG_USB_CR0
.set USBFS_1_USB__CR1, CYREG_USB_CR1
.set USBFS_1_USB__CWA, CYREG_USB_CWA
.set USBFS_1_USB__CWA_MSB, CYREG_USB_CWA_MSB
.set USBFS_1_USB__DMA_THRES, CYREG_USB_DMA_THRES
.set USBFS_1_USB__DMA_THRES_MSB, CYREG_USB_DMA_THRES_MSB
.set USBFS_1_USB__DYN_RECONFIG, CYREG_USB_DYN_RECONFIG
.set USBFS_1_USB__EP0_CNT, CYREG_USB_EP0_CNT
.set USBFS_1_USB__EP0_CR, CYREG_USB_EP0_CR
.set USBFS_1_USB__EP0_DR0, CYREG_USB_EP0_DR0
.set USBFS_1_USB__EP0_DR1, CYREG_USB_EP0_DR1
.set USBFS_1_USB__EP0_DR2, CYREG_USB_EP0_DR2
.set USBFS_1_USB__EP0_DR3, CYREG_USB_EP0_DR3
.set USBFS_1_USB__EP0_DR4, CYREG_USB_EP0_DR4
.set USBFS_1_USB__EP0_DR5, CYREG_USB_EP0_DR5
.set USBFS_1_USB__EP0_DR6, CYREG_USB_EP0_DR6
.set USBFS_1_USB__EP0_DR7, CYREG_USB_EP0_DR7
.set USBFS_1_USB__EP_ACTIVE, CYREG_USB_EP_ACTIVE
.set USBFS_1_USB__EP_TYPE, CYREG_USB_EP_TYPE
.set USBFS_1_USB__MEM_DATA, CYREG_USB_MEM_DATA_MBASE
.set USBFS_1_USB__PM_ACT_CFG, CYREG_PM_ACT_CFG5
.set USBFS_1_USB__PM_ACT_MSK, 0x01
.set USBFS_1_USB__PM_STBY_CFG, CYREG_PM_STBY_CFG5
.set USBFS_1_USB__PM_STBY_MSK, 0x01
.set USBFS_1_USB__SIE_EP1_CNT0, CYREG_USB_SIE_EP1_CNT0
.set USBFS_1_USB__SIE_EP1_CNT1, CYREG_USB_SIE_EP1_CNT1
.set USBFS_1_USB__SIE_EP1_CR0, CYREG_USB_SIE_EP1_CR0
.set USBFS_1_USB__SIE_EP2_CNT0, CYREG_USB_SIE_EP2_CNT0
.set USBFS_1_USB__SIE_EP2_CNT1, CYREG_USB_SIE_EP2_CNT1
.set USBFS_1_USB__SIE_EP2_CR0, CYREG_USB_SIE_EP2_CR0
.set USBFS_1_USB__SIE_EP3_CNT0, CYREG_USB_SIE_EP3_CNT0
.set USBFS_1_USB__SIE_EP3_CNT1, CYREG_USB_SIE_EP3_CNT1
.set USBFS_1_USB__SIE_EP3_CR0, CYREG_USB_SIE_EP3_CR0
.set USBFS_1_USB__SIE_EP4_CNT0, CYREG_USB_SIE_EP4_CNT0
.set USBFS_1_USB__SIE_EP4_CNT1, CYREG_USB_SIE_EP4_CNT1
.set USBFS_1_USB__SIE_EP4_CR0, CYREG_USB_SIE_EP4_CR0
.set USBFS_1_USB__SIE_EP5_CNT0, CYREG_USB_SIE_EP5_CNT0
.set USBFS_1_USB__SIE_EP5_CNT1, CYREG_USB_SIE_EP5_CNT1
.set USBFS_1_USB__SIE_EP5_CR0, CYREG_USB_SIE_EP5_CR0
.set USBFS_1_USB__SIE_EP6_CNT0, CYREG_USB_SIE_EP6_CNT0
.set USBFS_1_USB__SIE_EP6_CNT1, CYREG_USB_SIE_EP6_CNT1
.set USBFS_1_USB__SIE_EP6_CR0, CYREG_USB_SIE_EP6_CR0
.set USBFS_1_USB__SIE_EP7_CNT0, CYREG_USB_SIE_EP7_CNT0
.set USBFS_1_USB__SIE_EP7_CNT1, CYREG_USB_SIE_EP7_CNT1
.set USBFS_1_USB__SIE_EP7_CR0, CYREG_USB_SIE_EP7_CR0
.set USBFS_1_USB__SIE_EP8_CNT0, CYREG_USB_SIE_EP8_CNT0
.set USBFS_1_USB__SIE_EP8_CNT1, CYREG_USB_SIE_EP8_CNT1
.set USBFS_1_USB__SIE_EP8_CR0, CYREG_USB_SIE_EP8_CR0
.set USBFS_1_USB__SIE_EP_INT_EN, CYREG_USB_SIE_EP_INT_EN
.set USBFS_1_USB__SIE_EP_INT_SR, CYREG_USB_SIE_EP_INT_SR
.set USBFS_1_USB__SOF0, CYREG_USB_SOF0
.set USBFS_1_USB__SOF1, CYREG_USB_SOF1
.set USBFS_1_USB__USBIO_CR0, CYREG_USB_USBIO_CR0
.set USBFS_1_USB__USBIO_CR1, CYREG_USB_USBIO_CR1
.set USBFS_1_USB__USB_CLK_EN, CYREG_USB_USB_CLK_EN

/* PWM_PWMUDB */
.set PWM_PWMUDB_genblk1_ctrlreg__16BIT_CONTROL_AUX_CTL_REG, CYREG_B0_UDB11_12_ACTL
.set PWM_PWMUDB_genblk1_ctrlreg__16BIT_CONTROL_CONTROL_REG, CYREG_B0_UDB11_12_CTL
.set PWM_PWMUDB_genblk1_ctrlreg__16BIT_CONTROL_COUNT_REG, CYREG_B0_UDB11_12_CTL
.set PWM_PWMUDB_genblk1_ctrlreg__16BIT_COUNT_CONTROL_REG, CYREG_B0_UDB11_12_CTL
.set PWM_PWMUDB_genblk1_ctrlreg__16BIT_COUNT_COUNT_REG, CYREG_B0_UDB11_12_CTL
.set PWM_PWMUDB_genblk1_ctrlreg__16BIT_MASK_MASK_REG, CYREG_B0_UDB11_12_MSK
.set PWM_PWMUDB_genblk1_ctrlreg__16BIT_MASK_PERIOD_REG, CYREG_B0_UDB11_12_MSK
.set PWM_PWMUDB_genblk1_ctrlreg__16BIT_PERIOD_MASK_REG, CYREG_B0_UDB11_12_MSK
.set PWM_PWMUDB_genblk1_ctrlreg__16BIT_PERIOD_PERIOD_REG, CYREG_B0_UDB11_12_MSK
.set PWM_PWMUDB_genblk1_ctrlreg__7__MASK, 0x80
.set PWM_PWMUDB_genblk1_ctrlreg__7__POS, 7
.set PWM_PWMUDB_genblk1_ctrlreg__CONTROL_AUX_CTL_REG, CYREG_B0_UDB11_ACTL
.set PWM_PWMUDB_genblk1_ctrlreg__CONTROL_REG, CYREG_B0_UDB11_CTL
.set PWM_PWMUDB_genblk1_ctrlreg__CONTROL_ST_REG, CYREG_B0_UDB11_ST_CTL
.set PWM_PWMUDB_genblk1_ctrlreg__COUNT_REG, CYREG_B0_UDB11_CTL
.set PWM_PWMUDB_genblk1_ctrlreg__COUNT_ST_REG, CYREG_B0_UDB11_ST_CTL
.set PWM_PWMUDB_genblk1_ctrlreg__MASK, 0x80
.set PWM_PWMUDB_genblk1_ctrlreg__MASK_CTL_AUX_CTL_REG, CYREG_B0_UDB11_MSK_ACTL
.set PWM_PWMUDB_genblk1_ctrlreg__PERIOD_REG, CYREG_B0_UDB11_MSK
.set PWM_PWMUDB_genblk1_ctrlreg__PER_CTL_AUX_CTL_REG, CYREG_B0_UDB11_MSK_ACTL
.set PWM_PWMUDB_genblk8_stsreg__0__MASK, 0x01
.set PWM_PWMUDB_genblk8_stsreg__0__POS, 0
.set PWM_PWMUDB_genblk8_stsreg__16BIT_STATUS_AUX_CTL_REG, CYREG_B0_UDB11_12_ACTL
.set PWM_PWMUDB_genblk8_stsreg__16BIT_STATUS_REG, CYREG_B0_UDB11_12_ST
.set PWM_PWMUDB_genblk8_stsreg__2__MASK, 0x04
.set PWM_PWMUDB_genblk8_stsreg__2__POS, 2
.set PWM_PWMUDB_genblk8_stsreg__3__MASK, 0x08
.set PWM_PWMUDB_genblk8_stsreg__3__POS, 3
.set PWM_PWMUDB_genblk8_stsreg__5__MASK, 0x20
.set PWM_PWMUDB_genblk8_stsreg__5__POS, 5
.set PWM_PWMUDB_genblk8_stsreg__MASK, 0x2D
.set PWM_PWMUDB_genblk8_stsreg__MASK_REG, CYREG_B0_UDB11_MSK
.set PWM_PWMUDB_genblk8_stsreg__MASK_ST_AUX_CTL_REG, CYREG_B0_UDB11_MSK_ACTL
.set PWM_PWMUDB_genblk8_stsreg__PER_ST_AUX_CTL_REG, CYREG_B0_UDB11_MSK_ACTL
.set PWM_PWMUDB_genblk8_stsreg__STATUS_AUX_CTL_REG, CYREG_B0_UDB11_ACTL
.set PWM_PWMUDB_genblk8_stsreg__STATUS_CNT_REG, CYREG_B0_UDB11_ST_CTL
.set PWM_PWMUDB_genblk8_stsreg__STATUS_CONTROL_REG, CYREG_B0_UDB11_ST_CTL
.set PWM_PWMUDB_genblk8_stsreg__STATUS_REG, CYREG_B0_UDB11_ST
.set PWM_PWMUDB_sP8_pwmdp_u0__16BIT_A0_REG, CYREG_B0_UDB11_12_A0
.set PWM_PWMUDB_sP8_pwmdp_u0__16BIT_A1_REG, CYREG_B0_UDB11_12_A1
.set PWM_PWMUDB_sP8_pwmdp_u0__16BIT_D0_REG, CYREG_B0_UDB11_12_D0
.set PWM_PWMUDB_sP8_pwmdp_u0__16BIT_D1_REG, CYREG_B0_UDB11_12_D1
.set PWM_PWMUDB_sP8_pwmdp_u0__16BIT_DP_AUX_CTL_REG, CYREG_B0_UDB11_12_ACTL
.set PWM_PWMUDB_sP8_pwmdp_u0__16BIT_F0_REG, CYREG_B0_UDB11_12_F0
.set PWM_PWMUDB_sP8_pwmdp_u0__16BIT_F1_REG, CYREG_B0_UDB11_12_F1
.set PWM_PWMUDB_sP8_pwmdp_u0__A0_A1_REG, CYREG_B0_UDB11_A0_A1
.set PWM_PWMUDB_sP8_pwmdp_u0__A0_REG, CYREG_B0_UDB11_A0
.set PWM_PWMUDB_sP8_pwmdp_u0__A1_REG, CYREG_B0_UDB11_A1
.set PWM_PWMUDB_sP8_pwmdp_u0__D0_D1_REG, CYREG_B0_UDB11_D0_D1
.set PWM_PWMUDB_sP8_pwmdp_u0__D0_REG, CYREG_B0_UDB11_D0
.set PWM_PWMUDB_sP8_pwmdp_u0__D1_REG, CYREG_B0_UDB11_D1
.set PWM_PWMUDB_sP8_pwmdp_u0__DP_AUX_CTL_REG, CYREG_B0_UDB11_ACTL
.set PWM_PWMUDB_sP8_pwmdp_u0__F0_F1_REG, CYREG_B0_UDB11_F0_F1
.set PWM_PWMUDB_sP8_pwmdp_u0__F0_REG, CYREG_B0_UDB11_F0
.set PWM_PWMUDB_sP8_pwmdp_u0__F1_REG, CYREG_B0_UDB11_F1
.set PWM_PWMUDB_sP8_pwmdp_u0__MSK_DP_AUX_CTL_REG, CYREG_B0_UDB11_MSK_ACTL
.set PWM_PWMUDB_sP8_pwmdp_u0__PER_DP_AUX_CTL_REG, CYREG_B0_UDB11_MSK_ACTL

/* USBFS_1_Dm */
.set USBFS_1_Dm__0__MASK, 0x80
.set USBFS_1_Dm__0__PC, CYREG_IO_PC_PRT15_7_6_PC1
.set USBFS_1_Dm__0__PORT, 15
.set USBFS_1_Dm__0__SHIFT, 7
.set USBFS_1_Dm__AG, CYREG_PRT15_AG
.set USBFS_1_Dm__AMUX, CYREG_PRT15_AMUX
.set USBFS_1_Dm__BIE, CYREG_PRT15_BIE
.set USBFS_1_Dm__BIT_MASK, CYREG_PRT15_BIT_MASK
.set USBFS_1_Dm__BYP, CYREG_PRT15_BYP
.set USBFS_1_Dm__CTL, CYREG_PRT15_CTL
.set USBFS_1_Dm__DM0, CYREG_PRT15_DM0
.set USBFS_1_Dm__DM1, CYREG_PRT15_DM1
.set USBFS_1_Dm__DM2, CYREG_PRT15_DM2
.set USBFS_1_Dm__DR, CYREG_PRT15_DR
.set USBFS_1_Dm__INP_DIS, CYREG_PRT15_INP_DIS
.set USBFS_1_Dm__LCD_COM_SEG, CYREG_PRT15_LCD_COM_SEG
.set USBFS_1_Dm__LCD_EN, CYREG_PRT15_LCD_EN
.set USBFS_1_Dm__MASK, 0x80
.set USBFS_1_Dm__PORT, 15
.set USBFS_1_Dm__PRT, CYREG_PRT15_PRT
.set USBFS_1_Dm__PRTDSI__CAPS_SEL, CYREG_PRT15_CAPS_SEL
.set USBFS_1_Dm__PRTDSI__DBL_SYNC_IN, CYREG_PRT15_DBL_SYNC_IN
.set USBFS_1_Dm__PRTDSI__OE_SEL0, CYREG_PRT15_OE_SEL0
.set USBFS_1_Dm__PRTDSI__OE_SEL1, CYREG_PRT15_OE_SEL1
.set USBFS_1_Dm__PRTDSI__OUT_SEL0, CYREG_PRT15_OUT_SEL0
.set USBFS_1_Dm__PRTDSI__OUT_SEL1, CYREG_PRT15_OUT_SEL1
.set USBFS_1_Dm__PRTDSI__SYNC_OUT, CYREG_PRT15_SYNC_OUT
.set USBFS_1_Dm__PS, CYREG_PRT15_PS
.set USBFS_1_Dm__SHIFT, 7
.set USBFS_1_Dm__SLW, CYREG_PRT15_SLW

/* USBFS_1_Dp */
.set USBFS_1_Dp__0__MASK, 0x40
.set USBFS_1_Dp__0__PC, CYREG_IO_PC_PRT15_7_6_PC0
.set USBFS_1_Dp__0__PORT, 15
.set USBFS_1_Dp__0__SHIFT, 6
.set USBFS_1_Dp__AG, CYREG_PRT15_AG
.set USBFS_1_Dp__AMUX, CYREG_PRT15_AMUX
.set USBFS_1_Dp__BIE, CYREG_PRT15_BIE
.set USBFS_1_Dp__BIT_MASK, CYREG_PRT15_BIT_MASK
.set USBFS_1_Dp__BYP, CYREG_PRT15_BYP
.set USBFS_1_Dp__CTL, CYREG_PRT15_CTL
.set USBFS_1_Dp__DM0, CYREG_PRT15_DM0
.set USBFS_1_Dp__DM1, CYREG_PRT15_DM1
.set USBFS_1_Dp__DM2, CYREG_PRT15_DM2
.set USBFS_1_Dp__DR, CYREG_PRT15_DR
.set USBFS_1_Dp__INP_DIS, CYREG_PRT15_INP_DIS
.set USBFS_1_Dp__INTSTAT, CYREG_PICU15_INTSTAT
.set USBFS_1_Dp__LCD_COM_SEG, CYREG_PRT15_LCD_COM_SEG
.set USBFS_1_Dp__LCD_EN, CYREG_PRT15_LCD_EN
.set USBFS_1_Dp__MASK, 0x40
.set USBFS_1_Dp__PORT, 15
.set USBFS_1_Dp__PRT, CYREG_PRT15_PRT
.set USBFS_1_Dp__PRTDSI__CAPS_SEL, CYREG_PRT15_CAPS_SEL
.set USBFS_1_Dp__PRTDSI__DBL_SYNC_IN, CYREG_PRT15_DBL_SYNC_IN
.set USBFS_1_Dp__PRTDSI__OE_SEL0, CYREG_PRT15_OE_SEL0
.set USBFS_1_Dp__PRTDSI__OE_SEL1, CYREG_PRT15_OE_SEL1
.set USBFS_1_Dp__PRTDSI__OUT_SEL0, CYREG_PRT15_OUT_SEL0
.set USBFS_1_Dp__PRTDSI__OUT_SEL1, CYREG_PRT15_OUT_SEL1
.set USBFS_1_Dp__PRTDSI__SYNC_OUT, CYREG_PRT15_SYNC_OUT
.set USBFS_1_Dp__PS, CYREG_PRT15_PS
.set USBFS_1_Dp__SHIFT, 6
.set USBFS_1_Dp__SLW, CYREG_PRT15_SLW
.set USBFS_1_Dp__SNAP, CYREG_PICU_15_SNAP_15

/* PWM_Clock */
.set PWM_Clock__CFG0, CYREG_CLKDIST_DCFG1_CFG0
.set PWM_Clock__CFG1, CYREG_CLKDIST_DCFG1_CFG1
.set PWM_Clock__CFG2, CYREG_CLKDIST_DCFG1_CFG2
.set PWM_Clock__CFG2_SRC_SEL_MASK, 0x07
.set PWM_Clock__INDEX, 0x01
.set PWM_Clock__PM_ACT_CFG, CYREG_PM_ACT_CFG2
.set PWM_Clock__PM_ACT_MSK, 0x02
.set PWM_Clock__PM_STBY_CFG, CYREG_PM_STBY_CFG2
.set PWM_Clock__PM_STBY_MSK, 0x02

/* ADC_DEC */
.set ADC_DEC__COHER, CYREG_DEC_COHER
.set ADC_DEC__CR, CYREG_DEC_CR
.set ADC_DEC__DR1, CYREG_DEC_DR1
.set ADC_DEC__DR2, CYREG_DEC_DR2
.set ADC_DEC__DR2H, CYREG_DEC_DR2H
.set ADC_DEC__GCOR, CYREG_DEC_GCOR
.set ADC_DEC__GCORH, CYREG_DEC_GCORH
.set ADC_DEC__GVAL, CYREG_DEC_GVAL
.set ADC_DEC__OCOR, CYREG_DEC_OCOR
.set ADC_DEC__OCORH, CYREG_DEC_OCORH
.set ADC_DEC__OCORM, CYREG_DEC_OCORM
.set ADC_DEC__OUTSAMP, CYREG_DEC_OUTSAMP
.set ADC_DEC__OUTSAMPH, CYREG_DEC_OUTSAMPH
.set ADC_DEC__OUTSAMPM, CYREG_DEC_OUTSAMPM
.set ADC_DEC__OUTSAMPS, CYREG_DEC_OUTSAMPS
.set ADC_DEC__PM_ACT_CFG, CYREG_PM_ACT_CFG10
.set ADC_DEC__PM_ACT_MSK, 0x01
.set ADC_DEC__PM_STBY_CFG, CYREG_PM_STBY_CFG10
.set ADC_DEC__PM_STBY_MSK, 0x01
.set ADC_DEC__SHIFT1, CYREG_DEC_SHIFT1
.set ADC_DEC__SHIFT2, CYREG_DEC_SHIFT2
.set ADC_DEC__SR, CYREG_DEC_SR
.set ADC_DEC__TRIM__M1, CYREG_FLSHID_CUST_TABLES_DEC_M1
.set ADC_DEC__TRIM__M2, CYREG_FLSHID_CUST_TABLES_DEC_M2
.set ADC_DEC__TRIM__M3, CYREG_FLSHID_CUST_TABLES_DEC_M3
.set ADC_DEC__TRIM__M4, CYREG_FLSHID_CUST_TABLES_DEC_M4
.set ADC_DEC__TRIM__M5, CYREG_FLSHID_CUST_TABLES_DEC_M5
.set ADC_DEC__TRIM__M6, CYREG_FLSHID_CUST_TABLES_DEC_M6
.set ADC_DEC__TRIM__M7, CYREG_FLSHID_CUST_TABLES_DEC_M7
.set ADC_DEC__TRIM__M8, CYREG_FLSHID_CUST_TABLES_DEC_M8

/* ADC_DSM */
.set ADC_DSM__BUF0, CYREG_DSM0_BUF0
.set ADC_DSM__BUF1, CYREG_DSM0_BUF1
.set ADC_DSM__BUF2, CYREG_DSM0_BUF2
.set ADC_DSM__BUF3, CYREG_DSM0_BUF3
.set ADC_DSM__CLK, CYREG_DSM0_CLK
.set ADC_DSM__CR0, CYREG_DSM0_CR0
.set ADC_DSM__CR1, CYREG_DSM0_CR1
.set ADC_DSM__CR10, CYREG_DSM0_CR10
.set ADC_DSM__CR11, CYREG_DSM0_CR11
.set ADC_DSM__CR12, CYREG_DSM0_CR12
.set ADC_DSM__CR13, CYREG_DSM0_CR13
.set ADC_DSM__CR14, CYREG_DSM0_CR14
.set ADC_DSM__CR15, CYREG_DSM0_CR15
.set ADC_DSM__CR16, CYREG_DSM0_CR16
.set ADC_DSM__CR17, CYREG_DSM0_CR17
.set ADC_DSM__CR2, CYREG_DSM0_CR2
.set ADC_DSM__CR3, CYREG_DSM0_CR3
.set ADC_DSM__CR4, CYREG_DSM0_CR4
.set ADC_DSM__CR5, CYREG_DSM0_CR5
.set ADC_DSM__CR6, CYREG_DSM0_CR6
.set ADC_DSM__CR7, CYREG_DSM0_CR7
.set ADC_DSM__CR8, CYREG_DSM0_CR8
.set ADC_DSM__CR9, CYREG_DSM0_CR9
.set ADC_DSM__DEM0, CYREG_DSM0_DEM0
.set ADC_DSM__DEM1, CYREG_DSM0_DEM1
.set ADC_DSM__MISC, CYREG_DSM0_MISC
.set ADC_DSM__OUT0, CYREG_DSM0_OUT0
.set ADC_DSM__OUT1, CYREG_DSM0_OUT1
.set ADC_DSM__REF0, CYREG_DSM0_REF0
.set ADC_DSM__REF1, CYREG_DSM0_REF1
.set ADC_DSM__REF2, CYREG_DSM0_REF2
.set ADC_DSM__REF3, CYREG_DSM0_REF3
.set ADC_DSM__RSVD1, CYREG_DSM0_RSVD1
.set ADC_DSM__SW0, CYREG_DSM0_SW0
.set ADC_DSM__SW2, CYREG_DSM0_SW2
.set ADC_DSM__SW3, CYREG_DSM0_SW3
.set ADC_DSM__SW4, CYREG_DSM0_SW4
.set ADC_DSM__SW6, CYREG_DSM0_SW6
.set ADC_DSM__TR0, CYREG_NPUMP_DSM_TR0
.set ADC_DSM__TST0, CYREG_DSM0_TST0
.set ADC_DSM__TST1, CYREG_DSM0_TST1

/* ADC_IRQ */
.set ADC_IRQ__INTC_CLR_EN_REG, CYREG_NVIC_CLRENA0
.set ADC_IRQ__INTC_CLR_PD_REG, CYREG_NVIC_CLRPEND0
.set ADC_IRQ__INTC_MASK, 0x20000000
.set ADC_IRQ__INTC_NUMBER, 29
.set ADC_IRQ__INTC_PRIOR_NUM, 7
.set ADC_IRQ__INTC_PRIOR_REG, CYREG_NVIC_PRI_29
.set ADC_IRQ__INTC_SET_EN_REG, CYREG_NVIC_SETENA0
.set ADC_IRQ__INTC_SET_PD_REG, CYREG_NVIC_SETPEND0

/* Pot_In */
.set Pot_In__0__MASK, 0x20
.set Pot_In__0__PC, CYREG_PRT6_PC5
.set Pot_In__0__PORT, 6
.set Pot_In__0__SHIFT, 5
.set Pot_In__AG, CYREG_PRT6_AG
.set Pot_In__AMUX, CYREG_PRT6_AMUX
.set Pot_In__BIE, CYREG_PRT6_BIE
.set Pot_In__BIT_MASK, CYREG_PRT6_BIT_MASK
.set Pot_In__BYP, CYREG_PRT6_BYP
.set Pot_In__CTL, CYREG_PRT6_CTL
.set Pot_In__DM0, CYREG_PRT6_DM0
.set Pot_In__DM1, CYREG_PRT6_DM1
.set Pot_In__DM2, CYREG_PRT6_DM2
.set Pot_In__DR, CYREG_PRT6_DR
.set Pot_In__INP_DIS, CYREG_PRT6_INP_DIS
.set Pot_In__LCD_COM_SEG, CYREG_PRT6_LCD_COM_SEG
.set Pot_In__LCD_EN, CYREG_PRT6_LCD_EN
.set Pot_In__MASK, 0x20
.set Pot_In__PORT, 6
.set Pot_In__PRT, CYREG_PRT6_PRT
.set Pot_In__PRTDSI__CAPS_SEL, CYREG_PRT6_CAPS_SEL
.set Pot_In__PRTDSI__DBL_SYNC_IN, CYREG_PRT6_DBL_SYNC_IN
.set Pot_In__PRTDSI__OE_SEL0, CYREG_PRT6_OE_SEL0
.set Pot_In__PRTDSI__OE_SEL1, CYREG_PRT6_OE_SEL1
.set Pot_In__PRTDSI__OUT_SEL0, CYREG_PRT6_OUT_SEL0
.set Pot_In__PRTDSI__OUT_SEL1, CYREG_PRT6_OUT_SEL1
.set Pot_In__PRTDSI__SYNC_OUT, CYREG_PRT6_SYNC_OUT
.set Pot_In__PS, CYREG_PRT6_PS
.set Pot_In__SHIFT, 5
.set Pot_In__SLW, CYREG_PRT6_SLW

/* LED_1 */
.set LED_1__0__MASK, 0x04
.set LED_1__0__PC, CYREG_PRT6_PC2
.set LED_1__0__PORT, 6
.set LED_1__0__SHIFT, 2
.set LED_1__AG, CYREG_PRT6_AG
.set LED_1__AMUX, CYREG_PRT6_AMUX
.set LED_1__BIE, CYREG_PRT6_BIE
.set LED_1__BIT_MASK, CYREG_PRT6_BIT_MASK
.set LED_1__BYP, CYREG_PRT6_BYP
.set LED_1__CTL, CYREG_PRT6_CTL
.set LED_1__DM0, CYREG_PRT6_DM0
.set LED_1__DM1, CYREG_PRT6_DM1
.set LED_1__DM2, CYREG_PRT6_DM2
.set LED_1__DR, CYREG_PRT6_DR
.set LED_1__INP_DIS, CYREG_PRT6_INP_DIS
.set LED_1__LCD_COM_SEG, CYREG_PRT6_LCD_COM_SEG
.set LED_1__LCD_EN, CYREG_PRT6_LCD_EN
.set LED_1__MASK, 0x04
.set LED_1__PORT, 6
.set LED_1__PRT, CYREG_PRT6_PRT
.set LED_1__PRTDSI__CAPS_SEL, CYREG_PRT6_CAPS_SEL
.set LED_1__PRTDSI__DBL_SYNC_IN, CYREG_PRT6_DBL_SYNC_IN
.set LED_1__PRTDSI__OE_SEL0, CYREG_PRT6_OE_SEL0
.set LED_1__PRTDSI__OE_SEL1, CYREG_PRT6_OE_SEL1
.set LED_1__PRTDSI__OUT_SEL0, CYREG_PRT6_OUT_SEL0
.set LED_1__PRTDSI__OUT_SEL1, CYREG_PRT6_OUT_SEL1
.set LED_1__PRTDSI__SYNC_OUT, CYREG_PRT6_SYNC_OUT
.set LED_1__PS, CYREG_PRT6_PS
.set LED_1__SHIFT, 2
.set LED_1__SLW, CYREG_PRT6_SLW

/* LED_2 */
.set LED_2__0__MASK, 0x08
.set LED_2__0__PC, CYREG_PRT6_PC3
.set LED_2__0__PORT, 6
.set LED_2__0__SHIFT, 3
.set LED_2__AG, CYREG_PRT6_AG
.set LED_2__AMUX, CYREG_PRT6_AMUX
.set LED_2__BIE, CYREG_PRT6_BIE
.set LED_2__BIT_MASK, CYREG_PRT6_BIT_MASK
.set LED_2__BYP, CYREG_PRT6_BYP
.set LED_2__CTL, CYREG_PRT6_CTL
.set LED_2__DM0, CYREG_PRT6_DM0
.set LED_2__DM1, CYREG_PRT6_DM1
.set LED_2__DM2, CYREG_PRT6_DM2
.set LED_2__DR, CYREG_PRT6_DR
.set LED_2__INP_DIS, CYREG_PRT6_INP_DIS
.set LED_2__LCD_COM_SEG, CYREG_PRT6_LCD_COM_SEG
.set LED_2__LCD_EN, CYREG_PRT6_LCD_EN
.set LED_2__MASK, 0x08
.set LED_2__PORT, 6
.set LED_2__PRT, CYREG_PRT6_PRT
.set LED_2__PRTDSI__CAPS_SEL, CYREG_PRT6_CAPS_SEL
.set LED_2__PRTDSI__DBL_SYNC_IN, CYREG_PRT6_DBL_SYNC_IN
.set LED_2__PRTDSI__OE_SEL0, CYREG_PRT6_OE_SEL0
.set LED_2__PRTDSI__OE_SEL1, CYREG_PRT6_OE_SEL1
.set LED_2__PRTDSI__OUT_SEL0, CYREG_PRT6_OUT_SEL0
.set LED_2__PRTDSI__OUT_SEL1, CYREG_PRT6_OUT_SEL1
.set LED_2__PRTDSI__SYNC_OUT, CYREG_PRT6_SYNC_OUT
.set LED_2__PS, CYREG_PRT6_PS
.set LED_2__SHIFT, 3
.set LED_2__SLW, CYREG_PRT6_SLW

/* SW_In */
.set SW_In__0__MASK, 0x02
.set SW_In__0__PC, CYREG_PRT6_PC1
.set SW_In__0__PORT, 6
.set SW_In__0__SHIFT, 1
.set SW_In__AG, CYREG_PRT6_AG
.set SW_In__AMUX, CYREG_PRT6_AMUX
.set SW_In__BIE, CYREG_PRT6_BIE
.set SW_In__BIT_MASK, CYREG_PRT6_BIT_MASK
.set SW_In__BYP, CYREG_PRT6_BYP
.set SW_In__CTL, CYREG_PRT6_CTL
.set SW_In__DM0, CYREG_PRT6_DM0
.set SW_In__DM1, CYREG_PRT6_DM1
.set SW_In__DM2, CYREG_PRT6_DM2
.set SW_In__DR, CYREG_PRT6_DR
.set SW_In__INP_DIS, CYREG_PRT6_INP_DIS
.set SW_In__LCD_COM_SEG, CYREG_PRT6_LCD_COM_SEG
.set SW_In__LCD_EN, CYREG_PRT6_LCD_EN
.set SW_In__MASK, 0x02
.set SW_In__PORT, 6
.set SW_In__PRT, CYREG_PRT6_PRT
.set SW_In__PRTDSI__CAPS_SEL, CYREG_PRT6_CAPS_SEL
.set SW_In__PRTDSI__DBL_SYNC_IN, CYREG_PRT6_DBL_SYNC_IN
.set SW_In__PRTDSI__OE_SEL0, CYREG_PRT6_OE_SEL0
.set SW_In__PRTDSI__OE_SEL1, CYREG_PRT6_OE_SEL1
.set SW_In__PRTDSI__OUT_SEL0, CYREG_PRT6_OUT_SEL0
.set SW_In__PRTDSI__OUT_SEL1, CYREG_PRT6_OUT_SEL1
.set SW_In__PRTDSI__SYNC_OUT, CYREG_PRT6_SYNC_OUT
.set SW_In__PS, CYREG_PRT6_PS
.set SW_In__SHIFT, 1
.set SW_In__SLW, CYREG_PRT6_SLW

/* Miscellaneous */
/* -- WARNING: define names containing LEOPARD or PANTHER are deprecated and will be removed in a future release */
.set CYDEV_DEBUGGING_DPS_SWD_SWV, 6
.set CYDEV_CONFIG_UNUSED_IO_AllowButWarn, 0
.set CYDEV_CONFIGURATION_MODE_COMPRESSED, 0
.set CYDEV_CONFIG_FASTBOOT_ENABLED, 1
.set CYDEV_CHIP_REV_PSOC5LP_PRODUCTION, 0
.set CYDEV_CHIP_REVISION_5B_PRODUCTION, 0
.set CYDEV_CHIP_MEMBER_5B, 4
.set CYDEV_CHIP_FAMILY_PSOC5, 3
.set CYDEV_CHIP_DIE_PSOC5LP, 4
.set CYDEV_CHIP_DIE_EXPECT, CYDEV_CHIP_DIE_PSOC5LP
.set BCLK__BUS_CLK__HZ, 24000000
.set BCLK__BUS_CLK__KHZ, 24000
.set BCLK__BUS_CLK__MHZ, 24
.set CYDEV_CHIP_DIE_ACTUAL, CYDEV_CHIP_DIE_EXPECT
.set CYDEV_CHIP_DIE_LEOPARD, 1
.set CYDEV_CHIP_DIE_PANTHER, 3
.set CYDEV_CHIP_DIE_PSOC4A, 2
.set CYDEV_CHIP_DIE_UNKNOWN, 0
.set CYDEV_CHIP_FAMILY_PSOC3, 1
.set CYDEV_CHIP_FAMILY_PSOC4, 2
.set CYDEV_CHIP_FAMILY_UNKNOWN, 0
.set CYDEV_CHIP_FAMILY_USED, CYDEV_CHIP_FAMILY_PSOC5
.set CYDEV_CHIP_JTAG_ID, 0x2E123069
.set CYDEV_CHIP_MEMBER_3A, 1
.set CYDEV_CHIP_MEMBER_4A, 2
.set CYDEV_CHIP_MEMBER_5A, 3
.set CYDEV_CHIP_MEMBER_UNKNOWN, 0
.set CYDEV_CHIP_MEMBER_USED, CYDEV_CHIP_MEMBER_5B
.set CYDEV_CHIP_REVISION_3A_ES1, 0
.set CYDEV_CHIP_REVISION_3A_ES2, 1
.set CYDEV_CHIP_REVISION_3A_ES3, 3
.set CYDEV_CHIP_REVISION_3A_PRODUCTION, 3
.set CYDEV_CHIP_REVISION_4A_ES0, 17
.set CYDEV_CHIP_REVISION_4A_PRODUCTION, 17
.set CYDEV_CHIP_REVISION_5A_ES0, 0
.set CYDEV_CHIP_REVISION_5A_ES1, 1
.set CYDEV_CHIP_REVISION_5A_PRODUCTION, 1
.set CYDEV_CHIP_REVISION_5B_ES0, 0
.set CYDEV_CHIP_REVISION_USED, CYDEV_CHIP_REVISION_5B_PRODUCTION
.set CYDEV_CHIP_REV_EXPECT, CYDEV_CHIP_REV_PSOC5LP_PRODUCTION
.set CYDEV_CHIP_REV_LEOPARD_ES1, 0
.set CYDEV_CHIP_REV_LEOPARD_ES2, 1
.set CYDEV_CHIP_REV_LEOPARD_ES3, 3
.set CYDEV_CHIP_REV_LEOPARD_PRODUCTION, 3
.set CYDEV_CHIP_REV_PANTHER_ES0, 0
.set CYDEV_CHIP_REV_PANTHER_ES1, 1
.set CYDEV_CHIP_REV_PANTHER_PRODUCTION, 1
.set CYDEV_CHIP_REV_PSOC4A_ES0, 17
.set CYDEV_CHIP_REV_PSOC4A_PRODUCTION, 17
.set CYDEV_CHIP_REV_PSOC5LP_ES0, 0
.set CYDEV_CONFIGURATION_COMPRESSED, 1
.set CYDEV_CONFIGURATION_DMA, 0
.set CYDEV_CONFIGURATION_ECC, 1
.set CYDEV_CONFIGURATION_IMOENABLED, CYDEV_CONFIG_FASTBOOT_ENABLED
.set CYDEV_CONFIGURATION_MODE, CYDEV_CONFIGURATION_MODE_COMPRESSED
.set CYDEV_CONFIGURATION_MODE_DMA, 2
.set CYDEV_CONFIGURATION_MODE_UNCOMPRESSED, 1
.set CYDEV_CONFIG_UNUSED_IO, CYDEV_CONFIG_UNUSED_IO_AllowButWarn
.set CYDEV_CONFIG_UNUSED_IO_AllowWithInfo, 1
.set CYDEV_CONFIG_UNUSED_IO_Disallowed, 2
.set CYDEV_DEBUGGING_DPS, CYDEV_DEBUGGING_DPS_SWD_SWV
.set CYDEV_DEBUGGING_DPS_Disable, 3
.set CYDEV_DEBUGGING_DPS_JTAG_4, 1
.set CYDEV_DEBUGGING_DPS_JTAG_5, 0
.set CYDEV_DEBUGGING_DPS_SWD, 2
.set CYDEV_DEBUGGING_ENABLE, 1
.set CYDEV_DEBUGGING_XRES, 0
.set CYDEV_DEBUG_ENABLE_MASK, 0x20
.set CYDEV_DEBUG_ENABLE_REGISTER, CYREG_MLOGIC_DEBUG
.set CYDEV_DMA_CHANNELS_AVAILABLE, 24
.set CYDEV_ECC_ENABLE, 0
.set CYDEV_HEAP_SIZE, 0x1000
.set CYDEV_INSTRUCT_CACHE_ENABLED, 1
.set CYDEV_INTR_RISING, 0x00000000
.set CYDEV_PROJ_TYPE, 0
.set CYDEV_PROJ_TYPE_BOOTLOADER, 1
.set CYDEV_PROJ_TYPE_LOADABLE, 2
.set CYDEV_PROJ_TYPE_MULTIAPPBOOTLOADER, 3
.set CYDEV_PROJ_TYPE_STANDARD, 0
.set CYDEV_PROTECTION_ENABLE, 0
.set CYDEV_STACK_SIZE, 0x4000
.set CYDEV_USB_CLK_OSC_LOCKING_ENABLED_AT_PWR_UP, 1
.set CYDEV_USE_BUNDLED_CMSIS, 1
.set CYDEV_VARIABLE_VDDA, 0
.set CYDEV_VDDA_MV, 5000
.set CYDEV_VDDD_MV, 5000
.set CYDEV_VDDIO0_MV, 5000
.set CYDEV_VDDIO1_MV, 5000
.set CYDEV_VDDIO2_MV, 5000
.set CYDEV_VDDIO3_MV, 5000
.set CYDEV_VIO0, 5
.set CYDEV_VIO0_MV, 5000
.set CYDEV_VIO1, 5
.set CYDEV_VIO1_MV, 5000
.set CYDEV_VIO2, 5
.set CYDEV_VIO2_MV, 5000
.set CYDEV_VIO3, 5
.set CYDEV_VIO3_MV, 5000
.set DMA_CHANNELS_USED__MASK0, 0x00000000
.set CYDEV_BOOTLOADER_ENABLE, 0
.endif
